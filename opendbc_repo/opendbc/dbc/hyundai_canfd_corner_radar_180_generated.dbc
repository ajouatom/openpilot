CM_ "AUTOGENERATED FILE, DO NOT EDIT";

CM_ "hyundai_canfd_corner_radar_180.dbc starts here";
VERSION ""

NS_ :

BS_:

BU_: XXX RADAR

BA_DEF_ BO_  "GenMsgCycleTime" INT 0 100000;
BA_DEF_DEF_  "GenMsgCycleTime" 0;

BO_ 384 CORNER_RADAR_180_OBJECTS_180: 32 RADAR
 SG_ SLOT1_CHECKSUM : 0|16@1+ (1,0) [0|65535] "" XXX
 SG_ SLOT1_COUNTER : 16|8@1+ (1,0) [0|255] "" XXX
 SG_ SLOT1_QUAL_LEVEL : 24|7@1+ (1,0) [0|100] "%" XXX
 SG_ SLOT1_ALIVE_AGE : 32|8@1+ (1,0) [0|255] "" XXX
 SG_ SLOT1_MOVING_FLAG : 40|4@1+ (1,0) [0|15] "" XXX
 SG_ SLOT1_ID : 44|7@1+ (1,0) [0|127] "" XXX
 SG_ SLOT1_WIDTH : 52|7@1+ (0.05,0) [0|6.35] "m" XXX
 SG_ SLOT1_CLASS : 60|3@1+ (1,0) [0|7] "" XXX
 SG_ SLOT1_REL_POS_X : 64|13@1+ (0.05,0) [0|409.55] "m" XXX
 SG_ SLOT1_REL_POS_Y : 78|12@1+ (0.05,-102.4) [-102.4|102.35] "m" XXX
 SG_ SLOT1_REL_VEL_X : 91|12@1+ (0.05,-100) [-100|104.75] "m/s" XXX
 SG_ SLOT1_REL_VEL_Y : 104|10@1+ (0.05,-25) [-25|26.15] "m/s" XXX
 SG_ SLOT1_REL_ACCEL_X : 115|9@1- (0.05,0) [-12.8|12.75] "m/s^2" XXX
 SG_ SLOT1_SYNC_FRAME_INDEX : 124|4@1+ (1,0) [0|15] "" XXX
 SG_ SLOT2_CHECKSUM : 128|16@1+ (1,0) [0|65535] "" XXX
 SG_ SLOT2_COUNTER : 144|8@1+ (1,0) [0|255] "" XXX
 SG_ SLOT2_QUAL_LEVEL : 152|7@1+ (1,0) [0|100] "%" XXX
 SG_ SLOT2_ALIVE_AGE : 160|8@1+ (1,0) [0|255] "" XXX
 SG_ SLOT2_MOVING_FLAG : 168|4@1+ (1,0) [0|15] "" XXX
 SG_ SLOT2_ID : 172|7@1+ (1,0) [0|127] "" XXX
 SG_ SLOT2_WIDTH : 180|7@1+ (0.05,0) [0|6.35] "m" XXX
 SG_ SLOT2_CLASS : 188|3@1+ (1,0) [0|7] "" XXX
 SG_ SLOT2_REL_POS_X : 192|13@1+ (0.05,0) [0|409.55] "m" XXX
 SG_ SLOT2_REL_POS_Y : 206|12@1+ (0.05,-102.4) [-102.4|102.35] "m" XXX
 SG_ SLOT2_REL_VEL_X : 219|12@1+ (0.05,-100) [-100|104.75] "m/s" XXX
 SG_ SLOT2_REL_VEL_Y : 232|10@1+ (0.05,-25) [-25|26.15] "m/s" XXX
 SG_ SLOT2_REL_ACCEL_X : 243|9@1- (0.05,0) [-12.8|12.75] "m/s^2" XXX
 SG_ SLOT2_SYNC_FRAME_INDEX : 252|4@1+ (1,0) [0|15] "" XXX
CM_ BO_ 384 "0x180 group candidate corner/front object container on bus 1. Same address 0x180 also appears as an 8-byte frame on bus 0/130, so inspect bus 1 in Cabana. Two 16-byte object slots are inferred from the sampled sampled rlog.";
BA_ "GenMsgCycleTime" BO_ 384 30;

BO_ 385 CORNER_RADAR_180_OBJECTS_181: 32 RADAR
 SG_ SLOT1_CHECKSUM : 0|16@1+ (1,0) [0|65535] "" XXX
 SG_ SLOT1_COUNTER : 16|8@1+ (1,0) [0|255] "" XXX
 SG_ SLOT1_QUAL_LEVEL : 24|7@1+ (1,0) [0|100] "%" XXX
 SG_ SLOT1_ALIVE_AGE : 32|8@1+ (1,0) [0|255] "" XXX
 SG_ SLOT1_MOVING_FLAG : 40|4@1+ (1,0) [0|15] "" XXX
 SG_ SLOT1_ID : 44|7@1+ (1,0) [0|127] "" XXX
 SG_ SLOT1_WIDTH : 52|7@1+ (0.05,0) [0|6.35] "m" XXX
 SG_ SLOT1_CLASS : 60|3@1+ (1,0) [0|7] "" XXX
 SG_ SLOT1_REL_POS_X : 64|13@1+ (0.05,0) [0|409.55] "m" XXX
 SG_ SLOT1_REL_POS_Y : 78|12@1+ (0.05,-102.4) [-102.4|102.35] "m" XXX
 SG_ SLOT1_REL_VEL_X : 91|12@1+ (0.05,-100) [-100|104.75] "m/s" XXX
 SG_ SLOT1_REL_VEL_Y : 104|10@1+ (0.05,-25) [-25|26.15] "m/s" XXX
 SG_ SLOT1_REL_ACCEL_X : 115|9@1- (0.05,0) [-12.8|12.75] "m/s^2" XXX
 SG_ SLOT1_SYNC_FRAME_INDEX : 124|4@1+ (1,0) [0|15] "" XXX
 SG_ SLOT2_CHECKSUM : 128|16@1+ (1,0) [0|65535] "" XXX
 SG_ SLOT2_COUNTER : 144|8@1+ (1,0) [0|255] "" XXX
 SG_ SLOT2_QUAL_LEVEL : 152|7@1+ (1,0) [0|100] "%" XXX
 SG_ SLOT2_ALIVE_AGE : 160|8@1+ (1,0) [0|255] "" XXX
 SG_ SLOT2_MOVING_FLAG : 168|4@1+ (1,0) [0|15] "" XXX
 SG_ SLOT2_ID : 172|7@1+ (1,0) [0|127] "" XXX
 SG_ SLOT2_WIDTH : 180|7@1+ (0.05,0) [0|6.35] "m" XXX
 SG_ SLOT2_CLASS : 188|3@1+ (1,0) [0|7] "" XXX
 SG_ SLOT2_REL_POS_X : 192|13@1+ (0.05,0) [0|409.55] "m" XXX
 SG_ SLOT2_REL_POS_Y : 206|12@1+ (0.05,-102.4) [-102.4|102.35] "m" XXX
 SG_ SLOT2_REL_VEL_X : 219|12@1+ (0.05,-100) [-100|104.75] "m/s" XXX
 SG_ SLOT2_REL_VEL_Y : 232|10@1+ (0.05,-25) [-25|26.15] "m/s" XXX
 SG_ SLOT2_REL_ACCEL_X : 243|9@1- (0.05,0) [-12.8|12.75] "m/s^2" XXX
 SG_ SLOT2_SYNC_FRAME_INDEX : 252|4@1+ (1,0) [0|15] "" XXX
CM_ BO_ 385 "0x180 group candidate corner/front object container on bus 1. Two 16-byte object slots are inferred from the sampled sampled rlog.";
BA_ "GenMsgCycleTime" BO_ 385 30;

BO_ 386 CORNER_RADAR_180_OBJECTS_182: 32 RADAR
 SG_ SLOT1_CHECKSUM : 0|16@1+ (1,0) [0|65535] "" XXX
 SG_ SLOT1_COUNTER : 16|8@1+ (1,0) [0|255] "" XXX
 SG_ SLOT1_QUAL_LEVEL : 24|7@1+ (1,0) [0|100] "%" XXX
 SG_ SLOT1_ALIVE_AGE : 32|8@1+ (1,0) [0|255] "" XXX
 SG_ SLOT1_MOVING_FLAG : 40|4@1+ (1,0) [0|15] "" XXX
 SG_ SLOT1_ID : 44|7@1+ (1,0) [0|127] "" XXX
 SG_ SLOT1_WIDTH : 52|7@1+ (0.05,0) [0|6.35] "m" XXX
 SG_ SLOT1_CLASS : 60|3@1+ (1,0) [0|7] "" XXX
 SG_ SLOT1_REL_POS_X : 64|13@1+ (0.05,0) [0|409.55] "m" XXX
 SG_ SLOT1_REL_POS_Y : 78|12@1+ (0.05,-102.4) [-102.4|102.35] "m" XXX
 SG_ SLOT1_REL_VEL_X : 91|12@1+ (0.05,-100) [-100|104.75] "m/s" XXX
 SG_ SLOT1_REL_VEL_Y : 104|10@1+ (0.05,-25) [-25|26.15] "m/s" XXX
 SG_ SLOT1_REL_ACCEL_X : 115|9@1- (0.05,0) [-12.8|12.75] "m/s^2" XXX
 SG_ SLOT1_SYNC_FRAME_INDEX : 124|4@1+ (1,0) [0|15] "" XXX
 SG_ SLOT2_CHECKSUM : 128|16@1+ (1,0) [0|65535] "" XXX
 SG_ SLOT2_COUNTER : 144|8@1+ (1,0) [0|255] "" XXX
 SG_ SLOT2_QUAL_LEVEL : 152|7@1+ (1,0) [0|100] "%" XXX
 SG_ SLOT2_ALIVE_AGE : 160|8@1+ (1,0) [0|255] "" XXX
 SG_ SLOT2_MOVING_FLAG : 168|4@1+ (1,0) [0|15] "" XXX
 SG_ SLOT2_ID : 172|7@1+ (1,0) [0|127] "" XXX
 SG_ SLOT2_WIDTH : 180|7@1+ (0.05,0) [0|6.35] "m" XXX
 SG_ SLOT2_CLASS : 188|3@1+ (1,0) [0|7] "" XXX
 SG_ SLOT2_REL_POS_X : 192|13@1+ (0.05,0) [0|409.55] "m" XXX
 SG_ SLOT2_REL_POS_Y : 206|12@1+ (0.05,-102.4) [-102.4|102.35] "m" XXX
 SG_ SLOT2_REL_VEL_X : 219|12@1+ (0.05,-100) [-100|104.75] "m/s" XXX
 SG_ SLOT2_REL_VEL_Y : 232|10@1+ (0.05,-25) [-25|26.15] "m/s" XXX
 SG_ SLOT2_REL_ACCEL_X : 243|9@1- (0.05,0) [-12.8|12.75] "m/s^2" XXX
 SG_ SLOT2_SYNC_FRAME_INDEX : 252|4@1+ (1,0) [0|15] "" XXX
CM_ BO_ 386 "0x180 group candidate corner/front object container on bus 1. Two 16-byte object slots are inferred from the sampled sampled rlog.";
BA_ "GenMsgCycleTime" BO_ 386 30;

BO_ 387 CORNER_RADAR_180_OBJECTS_183: 32 RADAR
 SG_ SLOT1_CHECKSUM : 0|16@1+ (1,0) [0|65535] "" XXX
 SG_ SLOT1_COUNTER : 16|8@1+ (1,0) [0|255] "" XXX
 SG_ SLOT1_QUAL_LEVEL : 24|7@1+ (1,0) [0|100] "%" XXX
 SG_ SLOT1_ALIVE_AGE : 32|8@1+ (1,0) [0|255] "" XXX
 SG_ SLOT1_MOVING_FLAG : 40|4@1+ (1,0) [0|15] "" XXX
 SG_ SLOT1_ID : 44|7@1+ (1,0) [0|127] "" XXX
 SG_ SLOT1_WIDTH : 52|7@1+ (0.05,0) [0|6.35] "m" XXX
 SG_ SLOT1_CLASS : 60|3@1+ (1,0) [0|7] "" XXX
 SG_ SLOT1_REL_POS_X : 64|13@1+ (0.05,0) [0|409.55] "m" XXX
 SG_ SLOT1_REL_POS_Y : 78|12@1+ (0.05,-102.4) [-102.4|102.35] "m" XXX
 SG_ SLOT1_REL_VEL_X : 91|12@1+ (0.05,-100) [-100|104.75] "m/s" XXX
 SG_ SLOT1_REL_VEL_Y : 104|10@1+ (0.05,-25) [-25|26.15] "m/s" XXX
 SG_ SLOT1_REL_ACCEL_X : 115|9@1- (0.05,0) [-12.8|12.75] "m/s^2" XXX
 SG_ SLOT1_SYNC_FRAME_INDEX : 124|4@1+ (1,0) [0|15] "" XXX
 SG_ SLOT2_CHECKSUM : 128|16@1+ (1,0) [0|65535] "" XXX
 SG_ SLOT2_COUNTER : 144|8@1+ (1,0) [0|255] "" XXX
 SG_ SLOT2_QUAL_LEVEL : 152|7@1+ (1,0) [0|100] "%" XXX
 SG_ SLOT2_ALIVE_AGE : 160|8@1+ (1,0) [0|255] "" XXX
 SG_ SLOT2_MOVING_FLAG : 168|4@1+ (1,0) [0|15] "" XXX
 SG_ SLOT2_ID : 172|7@1+ (1,0) [0|127] "" XXX
 SG_ SLOT2_WIDTH : 180|7@1+ (0.05,0) [0|6.35] "m" XXX
 SG_ SLOT2_CLASS : 188|3@1+ (1,0) [0|7] "" XXX
 SG_ SLOT2_REL_POS_X : 192|13@1+ (0.05,0) [0|409.55] "m" XXX
 SG_ SLOT2_REL_POS_Y : 206|12@1+ (0.05,-102.4) [-102.4|102.35] "m" XXX
 SG_ SLOT2_REL_VEL_X : 219|12@1+ (0.05,-100) [-100|104.75] "m/s" XXX
 SG_ SLOT2_REL_VEL_Y : 232|10@1+ (0.05,-25) [-25|26.15] "m/s" XXX
 SG_ SLOT2_REL_ACCEL_X : 243|9@1- (0.05,0) [-12.8|12.75] "m/s^2" XXX
 SG_ SLOT2_SYNC_FRAME_INDEX : 252|4@1+ (1,0) [0|15] "" XXX
CM_ BO_ 387 "0x180 group candidate corner/front object container on bus 1. Often empty in the sampled sampled rlog.";
BA_ "GenMsgCycleTime" BO_ 387 30;

BO_ 388 CORNER_RADAR_180_OBJECTS_184: 32 RADAR
 SG_ SLOT1_CHECKSUM : 0|16@1+ (1,0) [0|65535] "" XXX
 SG_ SLOT1_COUNTER : 16|8@1+ (1,0) [0|255] "" XXX
 SG_ SLOT1_QUAL_LEVEL : 24|7@1+ (1,0) [0|100] "%" XXX
 SG_ SLOT1_ALIVE_AGE : 32|8@1+ (1,0) [0|255] "" XXX
 SG_ SLOT1_MOVING_FLAG : 40|4@1+ (1,0) [0|15] "" XXX
 SG_ SLOT1_ID : 44|7@1+ (1,0) [0|127] "" XXX
 SG_ SLOT1_WIDTH : 52|7@1+ (0.05,0) [0|6.35] "m" XXX
 SG_ SLOT1_CLASS : 60|3@1+ (1,0) [0|7] "" XXX
 SG_ SLOT1_REL_POS_X : 64|13@1+ (0.05,0) [0|409.55] "m" XXX
 SG_ SLOT1_REL_POS_Y : 78|12@1+ (0.05,-102.4) [-102.4|102.35] "m" XXX
 SG_ SLOT1_REL_VEL_X : 91|12@1+ (0.05,-100) [-100|104.75] "m/s" XXX
 SG_ SLOT1_REL_VEL_Y : 104|10@1+ (0.05,-25) [-25|26.15] "m/s" XXX
 SG_ SLOT1_REL_ACCEL_X : 115|9@1- (0.05,0) [-12.8|12.75] "m/s^2" XXX
 SG_ SLOT1_SYNC_FRAME_INDEX : 124|4@1+ (1,0) [0|15] "" XXX
 SG_ SLOT2_CHECKSUM : 128|16@1+ (1,0) [0|65535] "" XXX
 SG_ SLOT2_COUNTER : 144|8@1+ (1,0) [0|255] "" XXX
 SG_ SLOT2_QUAL_LEVEL : 152|7@1+ (1,0) [0|100] "%" XXX
 SG_ SLOT2_ALIVE_AGE : 160|8@1+ (1,0) [0|255] "" XXX
 SG_ SLOT2_MOVING_FLAG : 168|4@1+ (1,0) [0|15] "" XXX
 SG_ SLOT2_ID : 172|7@1+ (1,0) [0|127] "" XXX
 SG_ SLOT2_WIDTH : 180|7@1+ (0.05,0) [0|6.35] "m" XXX
 SG_ SLOT2_CLASS : 188|3@1+ (1,0) [0|7] "" XXX
 SG_ SLOT2_REL_POS_X : 192|13@1+ (0.05,0) [0|409.55] "m" XXX
 SG_ SLOT2_REL_POS_Y : 206|12@1+ (0.05,-102.4) [-102.4|102.35] "m" XXX
 SG_ SLOT2_REL_VEL_X : 219|12@1+ (0.05,-100) [-100|104.75] "m/s" XXX
 SG_ SLOT2_REL_VEL_Y : 232|10@1+ (0.05,-25) [-25|26.15] "m/s" XXX
 SG_ SLOT2_REL_ACCEL_X : 243|9@1- (0.05,0) [-12.8|12.75] "m/s^2" XXX
 SG_ SLOT2_SYNC_FRAME_INDEX : 252|4@1+ (1,0) [0|15] "" XXX
CM_ BO_ 388 "0x180 group candidate corner/front object container on bus 1. Often empty in the sampled sampled rlog.";
BA_ "GenMsgCycleTime" BO_ 388 30;

BO_ 438 CORNER_RADAR_180_OBJECTS_1b6: 32 RADAR
 SG_ SLOT1_CHECKSUM : 0|16@1+ (1,0) [0|65535] "" XXX
 SG_ SLOT1_COUNTER : 16|8@1+ (1,0) [0|255] "" XXX
 SG_ SLOT1_QUAL_LEVEL : 24|7@1+ (1,0) [0|100] "%" XXX
 SG_ SLOT1_REL_POS_X : 64|13@1+ (0.05,0) [0|409.55] "m" XXX
 SG_ SLOT1_REL_POS_Y : 78|12@1+ (0.05,-102.4) [-102.4|102.35] "m" XXX
 SG_ SLOT1_REL_VEL_X : 91|12@1+ (0.05,-100) [-100|104.75] "m/s" XXX
 SG_ SLOT2_CHECKSUM : 128|16@1+ (1,0) [0|65535] "" XXX
 SG_ SLOT2_COUNTER : 144|8@1+ (1,0) [0|255] "" XXX
 SG_ SLOT2_QUAL_LEVEL : 152|7@1+ (1,0) [0|100] "%" XXX
 SG_ SLOT2_REL_POS_X : 192|13@1+ (0.05,0) [0|409.55] "m" XXX
 SG_ SLOT2_REL_POS_Y : 206|12@1+ (0.05,-102.4) [-102.4|102.35] "m" XXX
 SG_ SLOT2_REL_VEL_X : 219|12@1+ (0.05,-100) [-100|104.75] "m/s" XXX
CM_ BO_ 438 "0x180 group candidate second object bank. Mostly empty/default in sampled sampled rlog; reduced signals keep Cabana readable.";
BA_ "GenMsgCycleTime" BO_ 438 30;

BO_ 439 CORNER_RADAR_180_OBJECTS_1b7: 32 RADAR
 SG_ SLOT1_CHECKSUM : 0|16@1+ (1,0) [0|65535] "" XXX
 SG_ SLOT1_COUNTER : 16|8@1+ (1,0) [0|255] "" XXX
 SG_ SLOT1_QUAL_LEVEL : 24|7@1+ (1,0) [0|100] "%" XXX
 SG_ SLOT1_REL_POS_X : 64|13@1+ (0.05,0) [0|409.55] "m" XXX
 SG_ SLOT1_REL_POS_Y : 78|12@1+ (0.05,-102.4) [-102.4|102.35] "m" XXX
 SG_ SLOT1_REL_VEL_X : 91|12@1+ (0.05,-100) [-100|104.75] "m/s" XXX
 SG_ SLOT2_CHECKSUM : 128|16@1+ (1,0) [0|65535] "" XXX
 SG_ SLOT2_COUNTER : 144|8@1+ (1,0) [0|255] "" XXX
 SG_ SLOT2_QUAL_LEVEL : 152|7@1+ (1,0) [0|100] "%" XXX
 SG_ SLOT2_REL_POS_X : 192|13@1+ (0.05,0) [0|409.55] "m" XXX
 SG_ SLOT2_REL_POS_Y : 206|12@1+ (0.05,-102.4) [-102.4|102.35] "m" XXX
 SG_ SLOT2_REL_VEL_X : 219|12@1+ (0.05,-100) [-100|104.75] "m/s" XXX
CM_ BO_ 439 "0x180 group candidate second object bank. Mostly empty/default in sampled sampled rlog; reduced signals keep Cabana readable.";
BA_ "GenMsgCycleTime" BO_ 439 30;

BO_ 440 CORNER_RADAR_180_OBJECTS_1b8: 32 RADAR
 SG_ SLOT1_CHECKSUM : 0|16@1+ (1,0) [0|65535] "" XXX
 SG_ SLOT1_COUNTER : 16|8@1+ (1,0) [0|255] "" XXX
 SG_ SLOT1_QUAL_LEVEL : 24|7@1+ (1,0) [0|100] "%" XXX
 SG_ SLOT1_REL_POS_X : 64|13@1+ (0.05,0) [0|409.55] "m" XXX
 SG_ SLOT1_REL_POS_Y : 78|12@1+ (0.05,-102.4) [-102.4|102.35] "m" XXX
 SG_ SLOT1_REL_VEL_X : 91|12@1+ (0.05,-100) [-100|104.75] "m/s" XXX
 SG_ SLOT2_CHECKSUM : 128|16@1+ (1,0) [0|65535] "" XXX
 SG_ SLOT2_COUNTER : 144|8@1+ (1,0) [0|255] "" XXX
 SG_ SLOT2_QUAL_LEVEL : 152|7@1+ (1,0) [0|100] "%" XXX
 SG_ SLOT2_REL_POS_X : 192|13@1+ (0.05,0) [0|409.55] "m" XXX
 SG_ SLOT2_REL_POS_Y : 206|12@1+ (0.05,-102.4) [-102.4|102.35] "m" XXX
 SG_ SLOT2_REL_VEL_X : 219|12@1+ (0.05,-100) [-100|104.75] "m/s" XXX
CM_ BO_ 440 "0x180 group candidate second object bank. Mostly empty/default in sampled sampled rlog; reduced signals keep Cabana readable.";
BA_ "GenMsgCycleTime" BO_ 440 30;

BO_ 441 CORNER_RADAR_180_OBJECTS_1b9: 32 RADAR
 SG_ SLOT1_CHECKSUM : 0|16@1+ (1,0) [0|65535] "" XXX
 SG_ SLOT1_COUNTER : 16|8@1+ (1,0) [0|255] "" XXX
 SG_ SLOT1_QUAL_LEVEL : 24|7@1+ (1,0) [0|100] "%" XXX
 SG_ SLOT1_REL_POS_X : 64|13@1+ (0.05,0) [0|409.55] "m" XXX
 SG_ SLOT1_REL_POS_Y : 78|12@1+ (0.05,-102.4) [-102.4|102.35] "m" XXX
 SG_ SLOT1_REL_VEL_X : 91|12@1+ (0.05,-100) [-100|104.75] "m/s" XXX
 SG_ SLOT2_CHECKSUM : 128|16@1+ (1,0) [0|65535] "" XXX
 SG_ SLOT2_COUNTER : 144|8@1+ (1,0) [0|255] "" XXX
 SG_ SLOT2_QUAL_LEVEL : 152|7@1+ (1,0) [0|100] "%" XXX
 SG_ SLOT2_REL_POS_X : 192|13@1+ (0.05,0) [0|409.55] "m" XXX
 SG_ SLOT2_REL_POS_Y : 206|12@1+ (0.05,-102.4) [-102.4|102.35] "m" XXX
 SG_ SLOT2_REL_VEL_X : 219|12@1+ (0.05,-100) [-100|104.75] "m/s" XXX
CM_ BO_ 441 "0x180 group candidate second object bank. Mostly empty/default in sampled sampled rlog; reduced signals keep Cabana readable.";
BA_ "GenMsgCycleTime" BO_ 441 30;
