CM_ "AUTOGENERATED FILE, DO NOT EDIT";

CM_ "hyundai_canfd_corner_radar_235.dbc starts here";
VERSION ""

NS_ :

BS_:

BU_: XXX RADAR

BA_DEF_ BO_  "GenMsgCycleTime" INT 0 100000;
BA_DEF_DEF_  "GenMsgCycleTime" 0;

BO_ 560 CORNER_RADAR_235_STATUS_230: 16 RADAR
 SG_ CHECKSUM : 0|16@1+ (1,0) [0|65535] "" XXX
 SG_ COUNTER : 16|8@1+ (1,0) [0|255] "" XXX
 SG_ ACTIVE_OBJECT_MSG_COUNT : 24|8@1+ (1,0) [0|255] "" XXX
 SG_ STATUS_BYTE_4 : 32|8@1+ (1,0) [0|255] "" XXX
 SG_ STATUS_BYTE_5 : 40|8@1+ (1,0) [0|255] "" XXX
 SG_ STATUS_BYTE_6 : 48|8@1+ (1,0) [0|255] "" XXX
 SG_ STATUS_BYTE_7 : 56|8@1+ (1,0) [0|255] "" XXX
 SG_ STATUS_BYTE_8 : 64|8@1+ (1,0) [0|255] "" XXX
 SG_ STATUS_BYTE_9 : 72|8@1+ (1,0) [0|255] "" XXX
 SG_ STATUS_BYTE_10 : 80|8@1+ (1,0) [0|255] "" XXX
 SG_ STATUS_BYTE_11 : 88|8@1+ (1,0) [0|255] "" XXX
 SG_ STATUS_BYTE_12 : 96|8@1+ (1,0) [0|255] "" XXX
 SG_ STATUS_BYTE_13 : 104|8@1+ (1,0) [0|255] "" XXX
 SG_ STATUS_BYTE_14 : 112|8@1+ (1,0) [0|255] "" XXX
 SG_ STATUS_BYTE_15 : 120|8@1+ (1,0) [0|255] "" XXX
CM_ BO_ 560 "Candidate corner radar status/header on bus 1. Seen around 33 Hz near object messages 0x235-0x248. ACTIVE_OBJECT_MSG_COUNT matches the number of active 0x235+ object containers in the sampled route.";
BA_ "GenMsgCycleTime" BO_ 560 30;

BO_ 565 CORNER_RADAR_235_OBJECTS_235: 32 RADAR
 SG_ CHECKSUM : 0|16@1+ (1,0) [0|65535] "" XXX
 SG_ COUNTER : 16|8@1+ (1,0) [0|255] "" XXX
 SG_ OBJ_QUAL_LEVEL : 24|7@1+ (1,0) [0|100] "%" XXX
 SG_ OBJ_ALIVE_AGE : 32|8@1+ (1,0) [0|255] "" XXX
 SG_ OBJ_MOVING_FLAG : 40|4@1+ (1,0) [0|15] "" XXX
 SG_ OBJ_ID : 44|7@1+ (1,0) [0|127] "" XXX
 SG_ OBJ_WIDTH : 52|8@1+ (0.01,0) [0|2.55] "m" XXX
 SG_ OBJ_CLASS : 60|4@1+ (1,0) [0|15] "" XXX
 SG_ OBJ_REL_POS_X : 64|13@1+ (0.05,0) [0|409.55] "m" XXX
 SG_ OBJ_REL_POS_Y : 78|12@1+ (0.05,-102.4) [-102.4|102.35] "m" XXX
 SG_ OBJ_REL_VEL_X : 91|12@1+ (0.05,-100) [-100|104.75] "m/s" XXX
 SG_ OBJ_REL_VEL_Y : 104|10@1+ (0.05,-25) [-25|26.15] "m/s" XXX
 SG_ OBJ_REL_ACCEL_X : 115|9@1- (0.05,0) [-12.8|12.75] "m/s^2" XXX
 SG_ OBJ_SYNC_FRAME_INDEX : 124|4@1+ (1,0) [0|15] "" XXX
 SG_ OBJ_ABS_VEL_X : 128|12@1+ (0.05,-102.4) [-102.4|102.35] "m/s" XXX
 SG_ TAIL_SIGNAL_140 : 140|12@1+ (1,0) [0|4095] "" XXX
 SG_ TAIL_SIGNAL_152 : 152|7@1+ (1,0) [0|127] "" XXX
 SG_ TAIL_SIGNAL_160 : 160|8@1+ (1,0) [0|255] "" XXX
 SG_ TAIL_SIGNAL_168 : 168|4@1+ (1,0) [0|15] "" XXX
 SG_ TAIL_SIGNAL_172 : 172|7@1+ (1,0) [0|127] "" XXX
 SG_ TAIL_SIGNAL_180 : 180|7@1+ (1,0) [0|127] "" XXX
 SG_ TAIL_SIGNAL_188 : 188|3@1+ (1,0) [0|7] "" XXX
CM_ BO_ 565 "Candidate new corner radar object payload on bus 1. 0x235-0x248 run near 33 Hz. Signal split and scales are derived from the public ZENDAR CAN-FD DBC FR_CMR object layout, then checked against the sampled IONIQ 5 PE rlog. In the sample, 0x235-0x239 carry active objects and 0x23a-0x248 mostly carry default payloads.";
CM_ SG_ 565 OBJ_REL_POS_X "ZENDAR FR_CMR_Obj_RelPosX-compatible candidate. In the sampled route, active slots decode to plausible object longitudinal positions.";
CM_ SG_ 565 OBJ_REL_POS_Y "ZENDAR FR_CMR_Obj_RelPosY-compatible candidate. Negative values were seen for objects on the right side in the sampled route.";
CM_ SG_ 565 OBJ_REL_ACCEL_X "This matches the GitHub hit at 115|9@1- named FR_CMR_Obj_RelAccelXxxVal in the public ZENDAR evaluation DBC.";
CM_ SG_ 565 TAIL_SIGNAL_140 "Unconfirmed tail field. Public ZENDAR FR_CMR layout uses this region for the next object's absolute velocity/metadata, but bytes 24-31 were zero in the sampled IONIQ 5 PE route.";
BA_ "GenMsgCycleTime" BO_ 565 30;

BO_ 566 CORNER_RADAR_235_OBJECTS_236: 32 RADAR
 SG_ CHECKSUM : 0|16@1+ (1,0) [0|65535] "" XXX
 SG_ COUNTER : 16|8@1+ (1,0) [0|255] "" XXX
 SG_ OBJ_QUAL_LEVEL : 24|7@1+ (1,0) [0|100] "%" XXX
 SG_ OBJ_ALIVE_AGE : 32|8@1+ (1,0) [0|255] "" XXX
 SG_ OBJ_MOVING_FLAG : 40|4@1+ (1,0) [0|15] "" XXX
 SG_ OBJ_ID : 44|7@1+ (1,0) [0|127] "" XXX
 SG_ OBJ_WIDTH : 52|8@1+ (0.01,0) [0|2.55] "m" XXX
 SG_ OBJ_CLASS : 60|4@1+ (1,0) [0|15] "" XXX
 SG_ OBJ_REL_POS_X : 64|13@1+ (0.05,0) [0|409.55] "m" XXX
 SG_ OBJ_REL_POS_Y : 78|12@1+ (0.05,-102.4) [-102.4|102.35] "m" XXX
 SG_ OBJ_REL_VEL_X : 91|12@1+ (0.05,-100) [-100|104.75] "m/s" XXX
 SG_ OBJ_REL_VEL_Y : 104|10@1+ (0.05,-25) [-25|26.15] "m/s" XXX
 SG_ OBJ_REL_ACCEL_X : 115|9@1- (0.05,0) [-12.8|12.75] "m/s^2" XXX
 SG_ OBJ_SYNC_FRAME_INDEX : 124|4@1+ (1,0) [0|15] "" XXX
 SG_ OBJ_ABS_VEL_X : 128|12@1+ (0.05,-102.4) [-102.4|102.35] "m/s" XXX
 SG_ TAIL_SIGNAL_140 : 140|12@1+ (1,0) [0|4095] "" XXX
 SG_ TAIL_SIGNAL_152 : 152|7@1+ (1,0) [0|127] "" XXX
 SG_ TAIL_SIGNAL_160 : 160|8@1+ (1,0) [0|255] "" XXX
 SG_ TAIL_SIGNAL_168 : 168|4@1+ (1,0) [0|15] "" XXX
 SG_ TAIL_SIGNAL_172 : 172|7@1+ (1,0) [0|127] "" XXX
 SG_ TAIL_SIGNAL_180 : 180|7@1+ (1,0) [0|127] "" XXX
 SG_ TAIL_SIGNAL_188 : 188|3@1+ (1,0) [0|7] "" XXX
CM_ BO_ 566 "Candidate new corner radar object payload on bus 1. 0x235-0x248 run near 33 Hz. Signal split and scales are derived from the public ZENDAR CAN-FD DBC FR_CMR object layout, then checked against the sampled IONIQ 5 PE rlog. In the sample, 0x235-0x239 carry active objects and 0x23a-0x248 mostly carry default payloads.";
CM_ SG_ 566 OBJ_REL_POS_X "ZENDAR FR_CMR_Obj_RelPosX-compatible candidate. In the sampled route, active slots decode to plausible object longitudinal positions.";
CM_ SG_ 566 OBJ_REL_POS_Y "ZENDAR FR_CMR_Obj_RelPosY-compatible candidate. Negative values were seen for objects on the right side in the sampled route.";
CM_ SG_ 566 OBJ_REL_ACCEL_X "This matches the GitHub hit at 115|9@1- named FR_CMR_Obj_RelAccelXxxVal in the public ZENDAR evaluation DBC.";
CM_ SG_ 566 TAIL_SIGNAL_140 "Unconfirmed tail field. Public ZENDAR FR_CMR layout uses this region for the next object's absolute velocity/metadata, but bytes 24-31 were zero in the sampled IONIQ 5 PE route.";
BA_ "GenMsgCycleTime" BO_ 566 30;

BO_ 567 CORNER_RADAR_235_OBJECTS_237: 32 RADAR
 SG_ CHECKSUM : 0|16@1+ (1,0) [0|65535] "" XXX
 SG_ COUNTER : 16|8@1+ (1,0) [0|255] "" XXX
 SG_ OBJ_QUAL_LEVEL : 24|7@1+ (1,0) [0|100] "%" XXX
 SG_ OBJ_ALIVE_AGE : 32|8@1+ (1,0) [0|255] "" XXX
 SG_ OBJ_MOVING_FLAG : 40|4@1+ (1,0) [0|15] "" XXX
 SG_ OBJ_ID : 44|7@1+ (1,0) [0|127] "" XXX
 SG_ OBJ_WIDTH : 52|8@1+ (0.01,0) [0|2.55] "m" XXX
 SG_ OBJ_CLASS : 60|4@1+ (1,0) [0|15] "" XXX
 SG_ OBJ_REL_POS_X : 64|13@1+ (0.05,0) [0|409.55] "m" XXX
 SG_ OBJ_REL_POS_Y : 78|12@1+ (0.05,-102.4) [-102.4|102.35] "m" XXX
 SG_ OBJ_REL_VEL_X : 91|12@1+ (0.05,-100) [-100|104.75] "m/s" XXX
 SG_ OBJ_REL_VEL_Y : 104|10@1+ (0.05,-25) [-25|26.15] "m/s" XXX
 SG_ OBJ_REL_ACCEL_X : 115|9@1- (0.05,0) [-12.8|12.75] "m/s^2" XXX
 SG_ OBJ_SYNC_FRAME_INDEX : 124|4@1+ (1,0) [0|15] "" XXX
 SG_ OBJ_ABS_VEL_X : 128|12@1+ (0.05,-102.4) [-102.4|102.35] "m/s" XXX
 SG_ TAIL_SIGNAL_140 : 140|12@1+ (1,0) [0|4095] "" XXX
 SG_ TAIL_SIGNAL_152 : 152|7@1+ (1,0) [0|127] "" XXX
 SG_ TAIL_SIGNAL_160 : 160|8@1+ (1,0) [0|255] "" XXX
 SG_ TAIL_SIGNAL_168 : 168|4@1+ (1,0) [0|15] "" XXX
 SG_ TAIL_SIGNAL_172 : 172|7@1+ (1,0) [0|127] "" XXX
 SG_ TAIL_SIGNAL_180 : 180|7@1+ (1,0) [0|127] "" XXX
 SG_ TAIL_SIGNAL_188 : 188|3@1+ (1,0) [0|7] "" XXX
CM_ BO_ 567 "Candidate new corner radar object payload on bus 1. 0x235-0x248 run near 33 Hz. Signal split and scales are derived from the public ZENDAR CAN-FD DBC FR_CMR object layout, then checked against the sampled IONIQ 5 PE rlog. In the sample, 0x235-0x239 carry active objects and 0x23a-0x248 mostly carry default payloads.";
CM_ SG_ 567 OBJ_REL_POS_X "ZENDAR FR_CMR_Obj_RelPosX-compatible candidate. In the sampled route, active slots decode to plausible object longitudinal positions.";
CM_ SG_ 567 OBJ_REL_POS_Y "ZENDAR FR_CMR_Obj_RelPosY-compatible candidate. Negative values were seen for objects on the right side in the sampled route.";
CM_ SG_ 567 OBJ_REL_ACCEL_X "This matches the GitHub hit at 115|9@1- named FR_CMR_Obj_RelAccelXxxVal in the public ZENDAR evaluation DBC.";
CM_ SG_ 567 TAIL_SIGNAL_140 "Unconfirmed tail field. Public ZENDAR FR_CMR layout uses this region for the next object's absolute velocity/metadata, but bytes 24-31 were zero in the sampled IONIQ 5 PE route.";
BA_ "GenMsgCycleTime" BO_ 567 30;

BO_ 568 CORNER_RADAR_235_OBJECTS_238: 32 RADAR
 SG_ CHECKSUM : 0|16@1+ (1,0) [0|65535] "" XXX
 SG_ COUNTER : 16|8@1+ (1,0) [0|255] "" XXX
 SG_ OBJ_QUAL_LEVEL : 24|7@1+ (1,0) [0|100] "%" XXX
 SG_ OBJ_ALIVE_AGE : 32|8@1+ (1,0) [0|255] "" XXX
 SG_ OBJ_MOVING_FLAG : 40|4@1+ (1,0) [0|15] "" XXX
 SG_ OBJ_ID : 44|7@1+ (1,0) [0|127] "" XXX
 SG_ OBJ_WIDTH : 52|8@1+ (0.01,0) [0|2.55] "m" XXX
 SG_ OBJ_CLASS : 60|4@1+ (1,0) [0|15] "" XXX
 SG_ OBJ_REL_POS_X : 64|13@1+ (0.05,0) [0|409.55] "m" XXX
 SG_ OBJ_REL_POS_Y : 78|12@1+ (0.05,-102.4) [-102.4|102.35] "m" XXX
 SG_ OBJ_REL_VEL_X : 91|12@1+ (0.05,-100) [-100|104.75] "m/s" XXX
 SG_ OBJ_REL_VEL_Y : 104|10@1+ (0.05,-25) [-25|26.15] "m/s" XXX
 SG_ OBJ_REL_ACCEL_X : 115|9@1- (0.05,0) [-12.8|12.75] "m/s^2" XXX
 SG_ OBJ_SYNC_FRAME_INDEX : 124|4@1+ (1,0) [0|15] "" XXX
 SG_ OBJ_ABS_VEL_X : 128|12@1+ (0.05,-102.4) [-102.4|102.35] "m/s" XXX
 SG_ TAIL_SIGNAL_140 : 140|12@1+ (1,0) [0|4095] "" XXX
 SG_ TAIL_SIGNAL_152 : 152|7@1+ (1,0) [0|127] "" XXX
 SG_ TAIL_SIGNAL_160 : 160|8@1+ (1,0) [0|255] "" XXX
 SG_ TAIL_SIGNAL_168 : 168|4@1+ (1,0) [0|15] "" XXX
 SG_ TAIL_SIGNAL_172 : 172|7@1+ (1,0) [0|127] "" XXX
 SG_ TAIL_SIGNAL_180 : 180|7@1+ (1,0) [0|127] "" XXX
 SG_ TAIL_SIGNAL_188 : 188|3@1+ (1,0) [0|7] "" XXX
CM_ BO_ 568 "Candidate new corner radar object payload on bus 1. 0x235-0x248 run near 33 Hz. Signal split and scales are derived from the public ZENDAR CAN-FD DBC FR_CMR object layout, then checked against the sampled IONIQ 5 PE rlog. In the sample, 0x235-0x239 carry active objects and 0x23a-0x248 mostly carry default payloads.";
CM_ SG_ 568 OBJ_REL_POS_X "ZENDAR FR_CMR_Obj_RelPosX-compatible candidate. In the sampled route, active slots decode to plausible object longitudinal positions.";
CM_ SG_ 568 OBJ_REL_POS_Y "ZENDAR FR_CMR_Obj_RelPosY-compatible candidate. Negative values were seen for objects on the right side in the sampled route.";
CM_ SG_ 568 OBJ_REL_ACCEL_X "This matches the GitHub hit at 115|9@1- named FR_CMR_Obj_RelAccelXxxVal in the public ZENDAR evaluation DBC.";
CM_ SG_ 568 TAIL_SIGNAL_140 "Unconfirmed tail field. Public ZENDAR FR_CMR layout uses this region for the next object's absolute velocity/metadata, but bytes 24-31 were zero in the sampled IONIQ 5 PE route.";
BA_ "GenMsgCycleTime" BO_ 568 30;

BO_ 569 CORNER_RADAR_235_OBJECTS_239: 32 RADAR
 SG_ CHECKSUM : 0|16@1+ (1,0) [0|65535] "" XXX
 SG_ COUNTER : 16|8@1+ (1,0) [0|255] "" XXX
 SG_ OBJ_QUAL_LEVEL : 24|7@1+ (1,0) [0|100] "%" XXX
 SG_ OBJ_ALIVE_AGE : 32|8@1+ (1,0) [0|255] "" XXX
 SG_ OBJ_MOVING_FLAG : 40|4@1+ (1,0) [0|15] "" XXX
 SG_ OBJ_ID : 44|7@1+ (1,0) [0|127] "" XXX
 SG_ OBJ_WIDTH : 52|8@1+ (0.01,0) [0|2.55] "m" XXX
 SG_ OBJ_CLASS : 60|4@1+ (1,0) [0|15] "" XXX
 SG_ OBJ_REL_POS_X : 64|13@1+ (0.05,0) [0|409.55] "m" XXX
 SG_ OBJ_REL_POS_Y : 78|12@1+ (0.05,-102.4) [-102.4|102.35] "m" XXX
 SG_ OBJ_REL_VEL_X : 91|12@1+ (0.05,-100) [-100|104.75] "m/s" XXX
 SG_ OBJ_REL_VEL_Y : 104|10@1+ (0.05,-25) [-25|26.15] "m/s" XXX
 SG_ OBJ_REL_ACCEL_X : 115|9@1- (0.05,0) [-12.8|12.75] "m/s^2" XXX
 SG_ OBJ_SYNC_FRAME_INDEX : 124|4@1+ (1,0) [0|15] "" XXX
 SG_ OBJ_ABS_VEL_X : 128|12@1+ (0.05,-102.4) [-102.4|102.35] "m/s" XXX
 SG_ TAIL_SIGNAL_140 : 140|12@1+ (1,0) [0|4095] "" XXX
 SG_ TAIL_SIGNAL_152 : 152|7@1+ (1,0) [0|127] "" XXX
 SG_ TAIL_SIGNAL_160 : 160|8@1+ (1,0) [0|255] "" XXX
 SG_ TAIL_SIGNAL_168 : 168|4@1+ (1,0) [0|15] "" XXX
 SG_ TAIL_SIGNAL_172 : 172|7@1+ (1,0) [0|127] "" XXX
 SG_ TAIL_SIGNAL_180 : 180|7@1+ (1,0) [0|127] "" XXX
 SG_ TAIL_SIGNAL_188 : 188|3@1+ (1,0) [0|7] "" XXX
CM_ BO_ 569 "Candidate new corner radar object payload on bus 1. 0x235-0x248 run near 33 Hz. Signal split and scales are derived from the public ZENDAR CAN-FD DBC FR_CMR object layout, then checked against the sampled IONIQ 5 PE rlog. In the sample, 0x235-0x239 carry active objects and 0x23a-0x248 mostly carry default payloads.";
CM_ SG_ 569 OBJ_REL_POS_X "ZENDAR FR_CMR_Obj_RelPosX-compatible candidate. In the sampled route, active slots decode to plausible object longitudinal positions.";
CM_ SG_ 569 OBJ_REL_POS_Y "ZENDAR FR_CMR_Obj_RelPosY-compatible candidate. Negative values were seen for objects on the right side in the sampled route.";
CM_ SG_ 569 OBJ_REL_ACCEL_X "This matches the GitHub hit at 115|9@1- named FR_CMR_Obj_RelAccelXxxVal in the public ZENDAR evaluation DBC.";
CM_ SG_ 569 TAIL_SIGNAL_140 "Unconfirmed tail field. Public ZENDAR FR_CMR layout uses this region for the next object's absolute velocity/metadata, but bytes 24-31 were zero in the sampled IONIQ 5 PE route.";
BA_ "GenMsgCycleTime" BO_ 569 30;

BO_ 570 CORNER_RADAR_235_OBJECTS_23a: 32 RADAR
 SG_ CHECKSUM : 0|16@1+ (1,0) [0|65535] "" XXX
 SG_ COUNTER : 16|8@1+ (1,0) [0|255] "" XXX
 SG_ OBJ_QUAL_LEVEL : 24|7@1+ (1,0) [0|100] "%" XXX
 SG_ OBJ_ALIVE_AGE : 32|8@1+ (1,0) [0|255] "" XXX
 SG_ OBJ_MOVING_FLAG : 40|4@1+ (1,0) [0|15] "" XXX
 SG_ OBJ_ID : 44|7@1+ (1,0) [0|127] "" XXX
 SG_ OBJ_WIDTH : 52|8@1+ (0.01,0) [0|2.55] "m" XXX
 SG_ OBJ_CLASS : 60|4@1+ (1,0) [0|15] "" XXX
 SG_ OBJ_REL_POS_X : 64|13@1+ (0.05,0) [0|409.55] "m" XXX
 SG_ OBJ_REL_POS_Y : 78|12@1+ (0.05,-102.4) [-102.4|102.35] "m" XXX
 SG_ OBJ_REL_VEL_X : 91|12@1+ (0.05,-100) [-100|104.75] "m/s" XXX
 SG_ OBJ_REL_VEL_Y : 104|10@1+ (0.05,-25) [-25|26.15] "m/s" XXX
 SG_ OBJ_REL_ACCEL_X : 115|9@1- (0.05,0) [-12.8|12.75] "m/s^2" XXX
 SG_ OBJ_SYNC_FRAME_INDEX : 124|4@1+ (1,0) [0|15] "" XXX
 SG_ OBJ_ABS_VEL_X : 128|12@1+ (0.05,-102.4) [-102.4|102.35] "m/s" XXX
 SG_ TAIL_SIGNAL_140 : 140|12@1+ (1,0) [0|4095] "" XXX
 SG_ TAIL_SIGNAL_152 : 152|7@1+ (1,0) [0|127] "" XXX
 SG_ TAIL_SIGNAL_160 : 160|8@1+ (1,0) [0|255] "" XXX
 SG_ TAIL_SIGNAL_168 : 168|4@1+ (1,0) [0|15] "" XXX
 SG_ TAIL_SIGNAL_172 : 172|7@1+ (1,0) [0|127] "" XXX
 SG_ TAIL_SIGNAL_180 : 180|7@1+ (1,0) [0|127] "" XXX
 SG_ TAIL_SIGNAL_188 : 188|3@1+ (1,0) [0|7] "" XXX
CM_ BO_ 570 "Candidate new corner radar object payload on bus 1. 0x235-0x248 run near 33 Hz. Signal split and scales are derived from the public ZENDAR CAN-FD DBC FR_CMR object layout, then checked against the sampled IONIQ 5 PE rlog. In the sample, 0x235-0x239 carry active objects and 0x23a-0x248 mostly carry default payloads.";
CM_ SG_ 570 OBJ_REL_POS_X "ZENDAR FR_CMR_Obj_RelPosX-compatible candidate. In the sampled route, active slots decode to plausible object longitudinal positions.";
CM_ SG_ 570 OBJ_REL_POS_Y "ZENDAR FR_CMR_Obj_RelPosY-compatible candidate. Negative values were seen for objects on the right side in the sampled route.";
CM_ SG_ 570 OBJ_REL_ACCEL_X "This matches the GitHub hit at 115|9@1- named FR_CMR_Obj_RelAccelXxxVal in the public ZENDAR evaluation DBC.";
CM_ SG_ 570 TAIL_SIGNAL_140 "Unconfirmed tail field. Public ZENDAR FR_CMR layout uses this region for the next object's absolute velocity/metadata, but bytes 24-31 were zero in the sampled IONIQ 5 PE route.";
BA_ "GenMsgCycleTime" BO_ 570 30;

BO_ 571 CORNER_RADAR_235_OBJECTS_23b: 32 RADAR
 SG_ CHECKSUM : 0|16@1+ (1,0) [0|65535] "" XXX
 SG_ COUNTER : 16|8@1+ (1,0) [0|255] "" XXX
 SG_ OBJ_QUAL_LEVEL : 24|7@1+ (1,0) [0|100] "%" XXX
 SG_ OBJ_ALIVE_AGE : 32|8@1+ (1,0) [0|255] "" XXX
 SG_ OBJ_MOVING_FLAG : 40|4@1+ (1,0) [0|15] "" XXX
 SG_ OBJ_ID : 44|7@1+ (1,0) [0|127] "" XXX
 SG_ OBJ_WIDTH : 52|8@1+ (0.01,0) [0|2.55] "m" XXX
 SG_ OBJ_CLASS : 60|4@1+ (1,0) [0|15] "" XXX
 SG_ OBJ_REL_POS_X : 64|13@1+ (0.05,0) [0|409.55] "m" XXX
 SG_ OBJ_REL_POS_Y : 78|12@1+ (0.05,-102.4) [-102.4|102.35] "m" XXX
 SG_ OBJ_REL_VEL_X : 91|12@1+ (0.05,-100) [-100|104.75] "m/s" XXX
 SG_ OBJ_REL_VEL_Y : 104|10@1+ (0.05,-25) [-25|26.15] "m/s" XXX
 SG_ OBJ_REL_ACCEL_X : 115|9@1- (0.05,0) [-12.8|12.75] "m/s^2" XXX
 SG_ OBJ_SYNC_FRAME_INDEX : 124|4@1+ (1,0) [0|15] "" XXX
 SG_ OBJ_ABS_VEL_X : 128|12@1+ (0.05,-102.4) [-102.4|102.35] "m/s" XXX
 SG_ TAIL_SIGNAL_140 : 140|12@1+ (1,0) [0|4095] "" XXX
 SG_ TAIL_SIGNAL_152 : 152|7@1+ (1,0) [0|127] "" XXX
 SG_ TAIL_SIGNAL_160 : 160|8@1+ (1,0) [0|255] "" XXX
 SG_ TAIL_SIGNAL_168 : 168|4@1+ (1,0) [0|15] "" XXX
 SG_ TAIL_SIGNAL_172 : 172|7@1+ (1,0) [0|127] "" XXX
 SG_ TAIL_SIGNAL_180 : 180|7@1+ (1,0) [0|127] "" XXX
 SG_ TAIL_SIGNAL_188 : 188|3@1+ (1,0) [0|7] "" XXX
CM_ BO_ 571 "Candidate new corner radar object payload on bus 1. 0x235-0x248 run near 33 Hz. Signal split and scales are derived from the public ZENDAR CAN-FD DBC FR_CMR object layout, then checked against the sampled IONIQ 5 PE rlog. In the sample, 0x235-0x239 carry active objects and 0x23a-0x248 mostly carry default payloads.";
CM_ SG_ 571 OBJ_REL_POS_X "ZENDAR FR_CMR_Obj_RelPosX-compatible candidate. In the sampled route, active slots decode to plausible object longitudinal positions.";
CM_ SG_ 571 OBJ_REL_POS_Y "ZENDAR FR_CMR_Obj_RelPosY-compatible candidate. Negative values were seen for objects on the right side in the sampled route.";
CM_ SG_ 571 OBJ_REL_ACCEL_X "This matches the GitHub hit at 115|9@1- named FR_CMR_Obj_RelAccelXxxVal in the public ZENDAR evaluation DBC.";
CM_ SG_ 571 TAIL_SIGNAL_140 "Unconfirmed tail field. Public ZENDAR FR_CMR layout uses this region for the next object's absolute velocity/metadata, but bytes 24-31 were zero in the sampled IONIQ 5 PE route.";
BA_ "GenMsgCycleTime" BO_ 571 30;

BO_ 572 CORNER_RADAR_235_OBJECTS_23c: 32 RADAR
 SG_ CHECKSUM : 0|16@1+ (1,0) [0|65535] "" XXX
 SG_ COUNTER : 16|8@1+ (1,0) [0|255] "" XXX
 SG_ OBJ_QUAL_LEVEL : 24|7@1+ (1,0) [0|100] "%" XXX
 SG_ OBJ_ALIVE_AGE : 32|8@1+ (1,0) [0|255] "" XXX
 SG_ OBJ_MOVING_FLAG : 40|4@1+ (1,0) [0|15] "" XXX
 SG_ OBJ_ID : 44|7@1+ (1,0) [0|127] "" XXX
 SG_ OBJ_WIDTH : 52|8@1+ (0.01,0) [0|2.55] "m" XXX
 SG_ OBJ_CLASS : 60|4@1+ (1,0) [0|15] "" XXX
 SG_ OBJ_REL_POS_X : 64|13@1+ (0.05,0) [0|409.55] "m" XXX
 SG_ OBJ_REL_POS_Y : 78|12@1+ (0.05,-102.4) [-102.4|102.35] "m" XXX
 SG_ OBJ_REL_VEL_X : 91|12@1+ (0.05,-100) [-100|104.75] "m/s" XXX
 SG_ OBJ_REL_VEL_Y : 104|10@1+ (0.05,-25) [-25|26.15] "m/s" XXX
 SG_ OBJ_REL_ACCEL_X : 115|9@1- (0.05,0) [-12.8|12.75] "m/s^2" XXX
 SG_ OBJ_SYNC_FRAME_INDEX : 124|4@1+ (1,0) [0|15] "" XXX
 SG_ OBJ_ABS_VEL_X : 128|12@1+ (0.05,-102.4) [-102.4|102.35] "m/s" XXX
 SG_ TAIL_SIGNAL_140 : 140|12@1+ (1,0) [0|4095] "" XXX
 SG_ TAIL_SIGNAL_152 : 152|7@1+ (1,0) [0|127] "" XXX
 SG_ TAIL_SIGNAL_160 : 160|8@1+ (1,0) [0|255] "" XXX
 SG_ TAIL_SIGNAL_168 : 168|4@1+ (1,0) [0|15] "" XXX
 SG_ TAIL_SIGNAL_172 : 172|7@1+ (1,0) [0|127] "" XXX
 SG_ TAIL_SIGNAL_180 : 180|7@1+ (1,0) [0|127] "" XXX
 SG_ TAIL_SIGNAL_188 : 188|3@1+ (1,0) [0|7] "" XXX
CM_ BO_ 572 "Candidate new corner radar object payload on bus 1. 0x235-0x248 run near 33 Hz. Signal split and scales are derived from the public ZENDAR CAN-FD DBC FR_CMR object layout, then checked against the sampled IONIQ 5 PE rlog. In the sample, 0x235-0x239 carry active objects and 0x23a-0x248 mostly carry default payloads.";
CM_ SG_ 572 OBJ_REL_POS_X "ZENDAR FR_CMR_Obj_RelPosX-compatible candidate. In the sampled route, active slots decode to plausible object longitudinal positions.";
CM_ SG_ 572 OBJ_REL_POS_Y "ZENDAR FR_CMR_Obj_RelPosY-compatible candidate. Negative values were seen for objects on the right side in the sampled route.";
CM_ SG_ 572 OBJ_REL_ACCEL_X "This matches the GitHub hit at 115|9@1- named FR_CMR_Obj_RelAccelXxxVal in the public ZENDAR evaluation DBC.";
CM_ SG_ 572 TAIL_SIGNAL_140 "Unconfirmed tail field. Public ZENDAR FR_CMR layout uses this region for the next object's absolute velocity/metadata, but bytes 24-31 were zero in the sampled IONIQ 5 PE route.";
BA_ "GenMsgCycleTime" BO_ 572 30;

BO_ 573 CORNER_RADAR_235_OBJECTS_23d: 32 RADAR
 SG_ CHECKSUM : 0|16@1+ (1,0) [0|65535] "" XXX
 SG_ COUNTER : 16|8@1+ (1,0) [0|255] "" XXX
 SG_ OBJ_QUAL_LEVEL : 24|7@1+ (1,0) [0|100] "%" XXX
 SG_ OBJ_ALIVE_AGE : 32|8@1+ (1,0) [0|255] "" XXX
 SG_ OBJ_MOVING_FLAG : 40|4@1+ (1,0) [0|15] "" XXX
 SG_ OBJ_ID : 44|7@1+ (1,0) [0|127] "" XXX
 SG_ OBJ_WIDTH : 52|8@1+ (0.01,0) [0|2.55] "m" XXX
 SG_ OBJ_CLASS : 60|4@1+ (1,0) [0|15] "" XXX
 SG_ OBJ_REL_POS_X : 64|13@1+ (0.05,0) [0|409.55] "m" XXX
 SG_ OBJ_REL_POS_Y : 78|12@1+ (0.05,-102.4) [-102.4|102.35] "m" XXX
 SG_ OBJ_REL_VEL_X : 91|12@1+ (0.05,-100) [-100|104.75] "m/s" XXX
 SG_ OBJ_REL_VEL_Y : 104|10@1+ (0.05,-25) [-25|26.15] "m/s" XXX
 SG_ OBJ_REL_ACCEL_X : 115|9@1- (0.05,0) [-12.8|12.75] "m/s^2" XXX
 SG_ OBJ_SYNC_FRAME_INDEX : 124|4@1+ (1,0) [0|15] "" XXX
 SG_ OBJ_ABS_VEL_X : 128|12@1+ (0.05,-102.4) [-102.4|102.35] "m/s" XXX
 SG_ TAIL_SIGNAL_140 : 140|12@1+ (1,0) [0|4095] "" XXX
 SG_ TAIL_SIGNAL_152 : 152|7@1+ (1,0) [0|127] "" XXX
 SG_ TAIL_SIGNAL_160 : 160|8@1+ (1,0) [0|255] "" XXX
 SG_ TAIL_SIGNAL_168 : 168|4@1+ (1,0) [0|15] "" XXX
 SG_ TAIL_SIGNAL_172 : 172|7@1+ (1,0) [0|127] "" XXX
 SG_ TAIL_SIGNAL_180 : 180|7@1+ (1,0) [0|127] "" XXX
 SG_ TAIL_SIGNAL_188 : 188|3@1+ (1,0) [0|7] "" XXX
CM_ BO_ 573 "Candidate new corner radar object payload on bus 1. 0x235-0x248 run near 33 Hz. Signal split and scales are derived from the public ZENDAR CAN-FD DBC FR_CMR object layout, then checked against the sampled IONIQ 5 PE rlog. In the sample, 0x235-0x239 carry active objects and 0x23a-0x248 mostly carry default payloads.";
CM_ SG_ 573 OBJ_REL_POS_X "ZENDAR FR_CMR_Obj_RelPosX-compatible candidate. In the sampled route, active slots decode to plausible object longitudinal positions.";
CM_ SG_ 573 OBJ_REL_POS_Y "ZENDAR FR_CMR_Obj_RelPosY-compatible candidate. Negative values were seen for objects on the right side in the sampled route.";
CM_ SG_ 573 OBJ_REL_ACCEL_X "This matches the GitHub hit at 115|9@1- named FR_CMR_Obj_RelAccelXxxVal in the public ZENDAR evaluation DBC.";
CM_ SG_ 573 TAIL_SIGNAL_140 "Unconfirmed tail field. Public ZENDAR FR_CMR layout uses this region for the next object's absolute velocity/metadata, but bytes 24-31 were zero in the sampled IONIQ 5 PE route.";
BA_ "GenMsgCycleTime" BO_ 573 30;

BO_ 574 CORNER_RADAR_235_OBJECTS_23e: 32 RADAR
 SG_ CHECKSUM : 0|16@1+ (1,0) [0|65535] "" XXX
 SG_ COUNTER : 16|8@1+ (1,0) [0|255] "" XXX
 SG_ OBJ_QUAL_LEVEL : 24|7@1+ (1,0) [0|100] "%" XXX
 SG_ OBJ_ALIVE_AGE : 32|8@1+ (1,0) [0|255] "" XXX
 SG_ OBJ_MOVING_FLAG : 40|4@1+ (1,0) [0|15] "" XXX
 SG_ OBJ_ID : 44|7@1+ (1,0) [0|127] "" XXX
 SG_ OBJ_WIDTH : 52|8@1+ (0.01,0) [0|2.55] "m" XXX
 SG_ OBJ_CLASS : 60|4@1+ (1,0) [0|15] "" XXX
 SG_ OBJ_REL_POS_X : 64|13@1+ (0.05,0) [0|409.55] "m" XXX
 SG_ OBJ_REL_POS_Y : 78|12@1+ (0.05,-102.4) [-102.4|102.35] "m" XXX
 SG_ OBJ_REL_VEL_X : 91|12@1+ (0.05,-100) [-100|104.75] "m/s" XXX
 SG_ OBJ_REL_VEL_Y : 104|10@1+ (0.05,-25) [-25|26.15] "m/s" XXX
 SG_ OBJ_REL_ACCEL_X : 115|9@1- (0.05,0) [-12.8|12.75] "m/s^2" XXX
 SG_ OBJ_SYNC_FRAME_INDEX : 124|4@1+ (1,0) [0|15] "" XXX
 SG_ OBJ_ABS_VEL_X : 128|12@1+ (0.05,-102.4) [-102.4|102.35] "m/s" XXX
 SG_ TAIL_SIGNAL_140 : 140|12@1+ (1,0) [0|4095] "" XXX
 SG_ TAIL_SIGNAL_152 : 152|7@1+ (1,0) [0|127] "" XXX
 SG_ TAIL_SIGNAL_160 : 160|8@1+ (1,0) [0|255] "" XXX
 SG_ TAIL_SIGNAL_168 : 168|4@1+ (1,0) [0|15] "" XXX
 SG_ TAIL_SIGNAL_172 : 172|7@1+ (1,0) [0|127] "" XXX
 SG_ TAIL_SIGNAL_180 : 180|7@1+ (1,0) [0|127] "" XXX
 SG_ TAIL_SIGNAL_188 : 188|3@1+ (1,0) [0|7] "" XXX
CM_ BO_ 574 "Candidate new corner radar object payload on bus 1. 0x235-0x248 run near 33 Hz. Signal split and scales are derived from the public ZENDAR CAN-FD DBC FR_CMR object layout, then checked against the sampled IONIQ 5 PE rlog. In the sample, 0x235-0x239 carry active objects and 0x23a-0x248 mostly carry default payloads.";
CM_ SG_ 574 OBJ_REL_POS_X "ZENDAR FR_CMR_Obj_RelPosX-compatible candidate. In the sampled route, active slots decode to plausible object longitudinal positions.";
CM_ SG_ 574 OBJ_REL_POS_Y "ZENDAR FR_CMR_Obj_RelPosY-compatible candidate. Negative values were seen for objects on the right side in the sampled route.";
CM_ SG_ 574 OBJ_REL_ACCEL_X "This matches the GitHub hit at 115|9@1- named FR_CMR_Obj_RelAccelXxxVal in the public ZENDAR evaluation DBC.";
CM_ SG_ 574 TAIL_SIGNAL_140 "Unconfirmed tail field. Public ZENDAR FR_CMR layout uses this region for the next object's absolute velocity/metadata, but bytes 24-31 were zero in the sampled IONIQ 5 PE route.";
BA_ "GenMsgCycleTime" BO_ 574 30;

BO_ 575 CORNER_RADAR_235_OBJECTS_23f: 32 RADAR
 SG_ CHECKSUM : 0|16@1+ (1,0) [0|65535] "" XXX
 SG_ COUNTER : 16|8@1+ (1,0) [0|255] "" XXX
 SG_ OBJ_QUAL_LEVEL : 24|7@1+ (1,0) [0|100] "%" XXX
 SG_ OBJ_ALIVE_AGE : 32|8@1+ (1,0) [0|255] "" XXX
 SG_ OBJ_MOVING_FLAG : 40|4@1+ (1,0) [0|15] "" XXX
 SG_ OBJ_ID : 44|7@1+ (1,0) [0|127] "" XXX
 SG_ OBJ_WIDTH : 52|8@1+ (0.01,0) [0|2.55] "m" XXX
 SG_ OBJ_CLASS : 60|4@1+ (1,0) [0|15] "" XXX
 SG_ OBJ_REL_POS_X : 64|13@1+ (0.05,0) [0|409.55] "m" XXX
 SG_ OBJ_REL_POS_Y : 78|12@1+ (0.05,-102.4) [-102.4|102.35] "m" XXX
 SG_ OBJ_REL_VEL_X : 91|12@1+ (0.05,-100) [-100|104.75] "m/s" XXX
 SG_ OBJ_REL_VEL_Y : 104|10@1+ (0.05,-25) [-25|26.15] "m/s" XXX
 SG_ OBJ_REL_ACCEL_X : 115|9@1- (0.05,0) [-12.8|12.75] "m/s^2" XXX
 SG_ OBJ_SYNC_FRAME_INDEX : 124|4@1+ (1,0) [0|15] "" XXX
 SG_ OBJ_ABS_VEL_X : 128|12@1+ (0.05,-102.4) [-102.4|102.35] "m/s" XXX
 SG_ TAIL_SIGNAL_140 : 140|12@1+ (1,0) [0|4095] "" XXX
 SG_ TAIL_SIGNAL_152 : 152|7@1+ (1,0) [0|127] "" XXX
 SG_ TAIL_SIGNAL_160 : 160|8@1+ (1,0) [0|255] "" XXX
 SG_ TAIL_SIGNAL_168 : 168|4@1+ (1,0) [0|15] "" XXX
 SG_ TAIL_SIGNAL_172 : 172|7@1+ (1,0) [0|127] "" XXX
 SG_ TAIL_SIGNAL_180 : 180|7@1+ (1,0) [0|127] "" XXX
 SG_ TAIL_SIGNAL_188 : 188|3@1+ (1,0) [0|7] "" XXX
CM_ BO_ 575 "Candidate new corner radar object payload on bus 1. 0x235-0x248 run near 33 Hz. Signal split and scales are derived from the public ZENDAR CAN-FD DBC FR_CMR object layout, then checked against the sampled IONIQ 5 PE rlog. In the sample, 0x235-0x239 carry active objects and 0x23a-0x248 mostly carry default payloads.";
CM_ SG_ 575 OBJ_REL_POS_X "ZENDAR FR_CMR_Obj_RelPosX-compatible candidate. In the sampled route, active slots decode to plausible object longitudinal positions.";
CM_ SG_ 575 OBJ_REL_POS_Y "ZENDAR FR_CMR_Obj_RelPosY-compatible candidate. Negative values were seen for objects on the right side in the sampled route.";
CM_ SG_ 575 OBJ_REL_ACCEL_X "This matches the GitHub hit at 115|9@1- named FR_CMR_Obj_RelAccelXxxVal in the public ZENDAR evaluation DBC.";
CM_ SG_ 575 TAIL_SIGNAL_140 "Unconfirmed tail field. Public ZENDAR FR_CMR layout uses this region for the next object's absolute velocity/metadata, but bytes 24-31 were zero in the sampled IONIQ 5 PE route.";
BA_ "GenMsgCycleTime" BO_ 575 30;

BO_ 576 CORNER_RADAR_235_OBJECTS_240: 32 RADAR
 SG_ CHECKSUM : 0|16@1+ (1,0) [0|65535] "" XXX
 SG_ COUNTER : 16|8@1+ (1,0) [0|255] "" XXX
 SG_ OBJ_QUAL_LEVEL : 24|7@1+ (1,0) [0|100] "%" XXX
 SG_ OBJ_ALIVE_AGE : 32|8@1+ (1,0) [0|255] "" XXX
 SG_ OBJ_MOVING_FLAG : 40|4@1+ (1,0) [0|15] "" XXX
 SG_ OBJ_ID : 44|7@1+ (1,0) [0|127] "" XXX
 SG_ OBJ_WIDTH : 52|8@1+ (0.01,0) [0|2.55] "m" XXX
 SG_ OBJ_CLASS : 60|4@1+ (1,0) [0|15] "" XXX
 SG_ OBJ_REL_POS_X : 64|13@1+ (0.05,0) [0|409.55] "m" XXX
 SG_ OBJ_REL_POS_Y : 78|12@1+ (0.05,-102.4) [-102.4|102.35] "m" XXX
 SG_ OBJ_REL_VEL_X : 91|12@1+ (0.05,-100) [-100|104.75] "m/s" XXX
 SG_ OBJ_REL_VEL_Y : 104|10@1+ (0.05,-25) [-25|26.15] "m/s" XXX
 SG_ OBJ_REL_ACCEL_X : 115|9@1- (0.05,0) [-12.8|12.75] "m/s^2" XXX
 SG_ OBJ_SYNC_FRAME_INDEX : 124|4@1+ (1,0) [0|15] "" XXX
 SG_ OBJ_ABS_VEL_X : 128|12@1+ (0.05,-102.4) [-102.4|102.35] "m/s" XXX
 SG_ TAIL_SIGNAL_140 : 140|12@1+ (1,0) [0|4095] "" XXX
 SG_ TAIL_SIGNAL_152 : 152|7@1+ (1,0) [0|127] "" XXX
 SG_ TAIL_SIGNAL_160 : 160|8@1+ (1,0) [0|255] "" XXX
 SG_ TAIL_SIGNAL_168 : 168|4@1+ (1,0) [0|15] "" XXX
 SG_ TAIL_SIGNAL_172 : 172|7@1+ (1,0) [0|127] "" XXX
 SG_ TAIL_SIGNAL_180 : 180|7@1+ (1,0) [0|127] "" XXX
 SG_ TAIL_SIGNAL_188 : 188|3@1+ (1,0) [0|7] "" XXX
CM_ BO_ 576 "Candidate new corner radar object payload on bus 1. 0x235-0x248 run near 33 Hz. Signal split and scales are derived from the public ZENDAR CAN-FD DBC FR_CMR object layout, then checked against the sampled IONIQ 5 PE rlog. In the sample, 0x235-0x239 carry active objects and 0x23a-0x248 mostly carry default payloads.";
CM_ SG_ 576 OBJ_REL_POS_X "ZENDAR FR_CMR_Obj_RelPosX-compatible candidate. In the sampled route, active slots decode to plausible object longitudinal positions.";
CM_ SG_ 576 OBJ_REL_POS_Y "ZENDAR FR_CMR_Obj_RelPosY-compatible candidate. Negative values were seen for objects on the right side in the sampled route.";
CM_ SG_ 576 OBJ_REL_ACCEL_X "This matches the GitHub hit at 115|9@1- named FR_CMR_Obj_RelAccelXxxVal in the public ZENDAR evaluation DBC.";
CM_ SG_ 576 TAIL_SIGNAL_140 "Unconfirmed tail field. Public ZENDAR FR_CMR layout uses this region for the next object's absolute velocity/metadata, but bytes 24-31 were zero in the sampled IONIQ 5 PE route.";
BA_ "GenMsgCycleTime" BO_ 576 30;

BO_ 577 CORNER_RADAR_235_OBJECTS_241: 32 RADAR
 SG_ CHECKSUM : 0|16@1+ (1,0) [0|65535] "" XXX
 SG_ COUNTER : 16|8@1+ (1,0) [0|255] "" XXX
 SG_ OBJ_QUAL_LEVEL : 24|7@1+ (1,0) [0|100] "%" XXX
 SG_ OBJ_ALIVE_AGE : 32|8@1+ (1,0) [0|255] "" XXX
 SG_ OBJ_MOVING_FLAG : 40|4@1+ (1,0) [0|15] "" XXX
 SG_ OBJ_ID : 44|7@1+ (1,0) [0|127] "" XXX
 SG_ OBJ_WIDTH : 52|8@1+ (0.01,0) [0|2.55] "m" XXX
 SG_ OBJ_CLASS : 60|4@1+ (1,0) [0|15] "" XXX
 SG_ OBJ_REL_POS_X : 64|13@1+ (0.05,0) [0|409.55] "m" XXX
 SG_ OBJ_REL_POS_Y : 78|12@1+ (0.05,-102.4) [-102.4|102.35] "m" XXX
 SG_ OBJ_REL_VEL_X : 91|12@1+ (0.05,-100) [-100|104.75] "m/s" XXX
 SG_ OBJ_REL_VEL_Y : 104|10@1+ (0.05,-25) [-25|26.15] "m/s" XXX
 SG_ OBJ_REL_ACCEL_X : 115|9@1- (0.05,0) [-12.8|12.75] "m/s^2" XXX
 SG_ OBJ_SYNC_FRAME_INDEX : 124|4@1+ (1,0) [0|15] "" XXX
 SG_ OBJ_ABS_VEL_X : 128|12@1+ (0.05,-102.4) [-102.4|102.35] "m/s" XXX
 SG_ TAIL_SIGNAL_140 : 140|12@1+ (1,0) [0|4095] "" XXX
 SG_ TAIL_SIGNAL_152 : 152|7@1+ (1,0) [0|127] "" XXX
 SG_ TAIL_SIGNAL_160 : 160|8@1+ (1,0) [0|255] "" XXX
 SG_ TAIL_SIGNAL_168 : 168|4@1+ (1,0) [0|15] "" XXX
 SG_ TAIL_SIGNAL_172 : 172|7@1+ (1,0) [0|127] "" XXX
 SG_ TAIL_SIGNAL_180 : 180|7@1+ (1,0) [0|127] "" XXX
 SG_ TAIL_SIGNAL_188 : 188|3@1+ (1,0) [0|7] "" XXX
CM_ BO_ 577 "Candidate new corner radar object payload on bus 1. 0x235-0x248 run near 33 Hz. Signal split and scales are derived from the public ZENDAR CAN-FD DBC FR_CMR object layout, then checked against the sampled IONIQ 5 PE rlog. In the sample, 0x235-0x239 carry active objects and 0x23a-0x248 mostly carry default payloads.";
CM_ SG_ 577 OBJ_REL_POS_X "ZENDAR FR_CMR_Obj_RelPosX-compatible candidate. In the sampled route, active slots decode to plausible object longitudinal positions.";
CM_ SG_ 577 OBJ_REL_POS_Y "ZENDAR FR_CMR_Obj_RelPosY-compatible candidate. Negative values were seen for objects on the right side in the sampled route.";
CM_ SG_ 577 OBJ_REL_ACCEL_X "This matches the GitHub hit at 115|9@1- named FR_CMR_Obj_RelAccelXxxVal in the public ZENDAR evaluation DBC.";
CM_ SG_ 577 TAIL_SIGNAL_140 "Unconfirmed tail field. Public ZENDAR FR_CMR layout uses this region for the next object's absolute velocity/metadata, but bytes 24-31 were zero in the sampled IONIQ 5 PE route.";
BA_ "GenMsgCycleTime" BO_ 577 30;

BO_ 578 CORNER_RADAR_235_OBJECTS_242: 32 RADAR
 SG_ CHECKSUM : 0|16@1+ (1,0) [0|65535] "" XXX
 SG_ COUNTER : 16|8@1+ (1,0) [0|255] "" XXX
 SG_ OBJ_QUAL_LEVEL : 24|7@1+ (1,0) [0|100] "%" XXX
 SG_ OBJ_ALIVE_AGE : 32|8@1+ (1,0) [0|255] "" XXX
 SG_ OBJ_MOVING_FLAG : 40|4@1+ (1,0) [0|15] "" XXX
 SG_ OBJ_ID : 44|7@1+ (1,0) [0|127] "" XXX
 SG_ OBJ_WIDTH : 52|8@1+ (0.01,0) [0|2.55] "m" XXX
 SG_ OBJ_CLASS : 60|4@1+ (1,0) [0|15] "" XXX
 SG_ OBJ_REL_POS_X : 64|13@1+ (0.05,0) [0|409.55] "m" XXX
 SG_ OBJ_REL_POS_Y : 78|12@1+ (0.05,-102.4) [-102.4|102.35] "m" XXX
 SG_ OBJ_REL_VEL_X : 91|12@1+ (0.05,-100) [-100|104.75] "m/s" XXX
 SG_ OBJ_REL_VEL_Y : 104|10@1+ (0.05,-25) [-25|26.15] "m/s" XXX
 SG_ OBJ_REL_ACCEL_X : 115|9@1- (0.05,0) [-12.8|12.75] "m/s^2" XXX
 SG_ OBJ_SYNC_FRAME_INDEX : 124|4@1+ (1,0) [0|15] "" XXX
 SG_ OBJ_ABS_VEL_X : 128|12@1+ (0.05,-102.4) [-102.4|102.35] "m/s" XXX
 SG_ TAIL_SIGNAL_140 : 140|12@1+ (1,0) [0|4095] "" XXX
 SG_ TAIL_SIGNAL_152 : 152|7@1+ (1,0) [0|127] "" XXX
 SG_ TAIL_SIGNAL_160 : 160|8@1+ (1,0) [0|255] "" XXX
 SG_ TAIL_SIGNAL_168 : 168|4@1+ (1,0) [0|15] "" XXX
 SG_ TAIL_SIGNAL_172 : 172|7@1+ (1,0) [0|127] "" XXX
 SG_ TAIL_SIGNAL_180 : 180|7@1+ (1,0) [0|127] "" XXX
 SG_ TAIL_SIGNAL_188 : 188|3@1+ (1,0) [0|7] "" XXX
CM_ BO_ 578 "Candidate new corner radar object payload on bus 1. 0x235-0x248 run near 33 Hz. Signal split and scales are derived from the public ZENDAR CAN-FD DBC FR_CMR object layout, then checked against the sampled IONIQ 5 PE rlog. In the sample, 0x235-0x239 carry active objects and 0x23a-0x248 mostly carry default payloads.";
CM_ SG_ 578 OBJ_REL_POS_X "ZENDAR FR_CMR_Obj_RelPosX-compatible candidate. In the sampled route, active slots decode to plausible object longitudinal positions.";
CM_ SG_ 578 OBJ_REL_POS_Y "ZENDAR FR_CMR_Obj_RelPosY-compatible candidate. Negative values were seen for objects on the right side in the sampled route.";
CM_ SG_ 578 OBJ_REL_ACCEL_X "This matches the GitHub hit at 115|9@1- named FR_CMR_Obj_RelAccelXxxVal in the public ZENDAR evaluation DBC.";
CM_ SG_ 578 TAIL_SIGNAL_140 "Unconfirmed tail field. Public ZENDAR FR_CMR layout uses this region for the next object's absolute velocity/metadata, but bytes 24-31 were zero in the sampled IONIQ 5 PE route.";
BA_ "GenMsgCycleTime" BO_ 578 30;

BO_ 579 CORNER_RADAR_235_OBJECTS_243: 32 RADAR
 SG_ CHECKSUM : 0|16@1+ (1,0) [0|65535] "" XXX
 SG_ COUNTER : 16|8@1+ (1,0) [0|255] "" XXX
 SG_ OBJ_QUAL_LEVEL : 24|7@1+ (1,0) [0|100] "%" XXX
 SG_ OBJ_ALIVE_AGE : 32|8@1+ (1,0) [0|255] "" XXX
 SG_ OBJ_MOVING_FLAG : 40|4@1+ (1,0) [0|15] "" XXX
 SG_ OBJ_ID : 44|7@1+ (1,0) [0|127] "" XXX
 SG_ OBJ_WIDTH : 52|8@1+ (0.01,0) [0|2.55] "m" XXX
 SG_ OBJ_CLASS : 60|4@1+ (1,0) [0|15] "" XXX
 SG_ OBJ_REL_POS_X : 64|13@1+ (0.05,0) [0|409.55] "m" XXX
 SG_ OBJ_REL_POS_Y : 78|12@1+ (0.05,-102.4) [-102.4|102.35] "m" XXX
 SG_ OBJ_REL_VEL_X : 91|12@1+ (0.05,-100) [-100|104.75] "m/s" XXX
 SG_ OBJ_REL_VEL_Y : 104|10@1+ (0.05,-25) [-25|26.15] "m/s" XXX
 SG_ OBJ_REL_ACCEL_X : 115|9@1- (0.05,0) [-12.8|12.75] "m/s^2" XXX
 SG_ OBJ_SYNC_FRAME_INDEX : 124|4@1+ (1,0) [0|15] "" XXX
 SG_ OBJ_ABS_VEL_X : 128|12@1+ (0.05,-102.4) [-102.4|102.35] "m/s" XXX
 SG_ TAIL_SIGNAL_140 : 140|12@1+ (1,0) [0|4095] "" XXX
 SG_ TAIL_SIGNAL_152 : 152|7@1+ (1,0) [0|127] "" XXX
 SG_ TAIL_SIGNAL_160 : 160|8@1+ (1,0) [0|255] "" XXX
 SG_ TAIL_SIGNAL_168 : 168|4@1+ (1,0) [0|15] "" XXX
 SG_ TAIL_SIGNAL_172 : 172|7@1+ (1,0) [0|127] "" XXX
 SG_ TAIL_SIGNAL_180 : 180|7@1+ (1,0) [0|127] "" XXX
 SG_ TAIL_SIGNAL_188 : 188|3@1+ (1,0) [0|7] "" XXX
CM_ BO_ 579 "Candidate new corner radar object payload on bus 1. 0x235-0x248 run near 33 Hz. Signal split and scales are derived from the public ZENDAR CAN-FD DBC FR_CMR object layout, then checked against the sampled IONIQ 5 PE rlog. In the sample, 0x235-0x239 carry active objects and 0x23a-0x248 mostly carry default payloads.";
CM_ SG_ 579 OBJ_REL_POS_X "ZENDAR FR_CMR_Obj_RelPosX-compatible candidate. In the sampled route, active slots decode to plausible object longitudinal positions.";
CM_ SG_ 579 OBJ_REL_POS_Y "ZENDAR FR_CMR_Obj_RelPosY-compatible candidate. Negative values were seen for objects on the right side in the sampled route.";
CM_ SG_ 579 OBJ_REL_ACCEL_X "This matches the GitHub hit at 115|9@1- named FR_CMR_Obj_RelAccelXxxVal in the public ZENDAR evaluation DBC.";
CM_ SG_ 579 TAIL_SIGNAL_140 "Unconfirmed tail field. Public ZENDAR FR_CMR layout uses this region for the next object's absolute velocity/metadata, but bytes 24-31 were zero in the sampled IONIQ 5 PE route.";
BA_ "GenMsgCycleTime" BO_ 579 30;

BO_ 580 CORNER_RADAR_235_OBJECTS_244: 32 RADAR
 SG_ CHECKSUM : 0|16@1+ (1,0) [0|65535] "" XXX
 SG_ COUNTER : 16|8@1+ (1,0) [0|255] "" XXX
 SG_ OBJ_QUAL_LEVEL : 24|7@1+ (1,0) [0|100] "%" XXX
 SG_ OBJ_ALIVE_AGE : 32|8@1+ (1,0) [0|255] "" XXX
 SG_ OBJ_MOVING_FLAG : 40|4@1+ (1,0) [0|15] "" XXX
 SG_ OBJ_ID : 44|7@1+ (1,0) [0|127] "" XXX
 SG_ OBJ_WIDTH : 52|8@1+ (0.01,0) [0|2.55] "m" XXX
 SG_ OBJ_CLASS : 60|4@1+ (1,0) [0|15] "" XXX
 SG_ OBJ_REL_POS_X : 64|13@1+ (0.05,0) [0|409.55] "m" XXX
 SG_ OBJ_REL_POS_Y : 78|12@1+ (0.05,-102.4) [-102.4|102.35] "m" XXX
 SG_ OBJ_REL_VEL_X : 91|12@1+ (0.05,-100) [-100|104.75] "m/s" XXX
 SG_ OBJ_REL_VEL_Y : 104|10@1+ (0.05,-25) [-25|26.15] "m/s" XXX
 SG_ OBJ_REL_ACCEL_X : 115|9@1- (0.05,0) [-12.8|12.75] "m/s^2" XXX
 SG_ OBJ_SYNC_FRAME_INDEX : 124|4@1+ (1,0) [0|15] "" XXX
 SG_ OBJ_ABS_VEL_X : 128|12@1+ (0.05,-102.4) [-102.4|102.35] "m/s" XXX
 SG_ TAIL_SIGNAL_140 : 140|12@1+ (1,0) [0|4095] "" XXX
 SG_ TAIL_SIGNAL_152 : 152|7@1+ (1,0) [0|127] "" XXX
 SG_ TAIL_SIGNAL_160 : 160|8@1+ (1,0) [0|255] "" XXX
 SG_ TAIL_SIGNAL_168 : 168|4@1+ (1,0) [0|15] "" XXX
 SG_ TAIL_SIGNAL_172 : 172|7@1+ (1,0) [0|127] "" XXX
 SG_ TAIL_SIGNAL_180 : 180|7@1+ (1,0) [0|127] "" XXX
 SG_ TAIL_SIGNAL_188 : 188|3@1+ (1,0) [0|7] "" XXX
CM_ BO_ 580 "Candidate new corner radar object payload on bus 1. 0x235-0x248 run near 33 Hz. Signal split and scales are derived from the public ZENDAR CAN-FD DBC FR_CMR object layout, then checked against the sampled IONIQ 5 PE rlog. In the sample, 0x235-0x239 carry active objects and 0x23a-0x248 mostly carry default payloads.";
CM_ SG_ 580 OBJ_REL_POS_X "ZENDAR FR_CMR_Obj_RelPosX-compatible candidate. In the sampled route, active slots decode to plausible object longitudinal positions.";
CM_ SG_ 580 OBJ_REL_POS_Y "ZENDAR FR_CMR_Obj_RelPosY-compatible candidate. Negative values were seen for objects on the right side in the sampled route.";
CM_ SG_ 580 OBJ_REL_ACCEL_X "This matches the GitHub hit at 115|9@1- named FR_CMR_Obj_RelAccelXxxVal in the public ZENDAR evaluation DBC.";
CM_ SG_ 580 TAIL_SIGNAL_140 "Unconfirmed tail field. Public ZENDAR FR_CMR layout uses this region for the next object's absolute velocity/metadata, but bytes 24-31 were zero in the sampled IONIQ 5 PE route.";
BA_ "GenMsgCycleTime" BO_ 580 30;

BO_ 581 CORNER_RADAR_235_OBJECTS_245: 32 RADAR
 SG_ CHECKSUM : 0|16@1+ (1,0) [0|65535] "" XXX
 SG_ COUNTER : 16|8@1+ (1,0) [0|255] "" XXX
 SG_ OBJ_QUAL_LEVEL : 24|7@1+ (1,0) [0|100] "%" XXX
 SG_ OBJ_ALIVE_AGE : 32|8@1+ (1,0) [0|255] "" XXX
 SG_ OBJ_MOVING_FLAG : 40|4@1+ (1,0) [0|15] "" XXX
 SG_ OBJ_ID : 44|7@1+ (1,0) [0|127] "" XXX
 SG_ OBJ_WIDTH : 52|8@1+ (0.01,0) [0|2.55] "m" XXX
 SG_ OBJ_CLASS : 60|4@1+ (1,0) [0|15] "" XXX
 SG_ OBJ_REL_POS_X : 64|13@1+ (0.05,0) [0|409.55] "m" XXX
 SG_ OBJ_REL_POS_Y : 78|12@1+ (0.05,-102.4) [-102.4|102.35] "m" XXX
 SG_ OBJ_REL_VEL_X : 91|12@1+ (0.05,-100) [-100|104.75] "m/s" XXX
 SG_ OBJ_REL_VEL_Y : 104|10@1+ (0.05,-25) [-25|26.15] "m/s" XXX
 SG_ OBJ_REL_ACCEL_X : 115|9@1- (0.05,0) [-12.8|12.75] "m/s^2" XXX
 SG_ OBJ_SYNC_FRAME_INDEX : 124|4@1+ (1,0) [0|15] "" XXX
 SG_ OBJ_ABS_VEL_X : 128|12@1+ (0.05,-102.4) [-102.4|102.35] "m/s" XXX
 SG_ TAIL_SIGNAL_140 : 140|12@1+ (1,0) [0|4095] "" XXX
 SG_ TAIL_SIGNAL_152 : 152|7@1+ (1,0) [0|127] "" XXX
 SG_ TAIL_SIGNAL_160 : 160|8@1+ (1,0) [0|255] "" XXX
 SG_ TAIL_SIGNAL_168 : 168|4@1+ (1,0) [0|15] "" XXX
 SG_ TAIL_SIGNAL_172 : 172|7@1+ (1,0) [0|127] "" XXX
 SG_ TAIL_SIGNAL_180 : 180|7@1+ (1,0) [0|127] "" XXX
 SG_ TAIL_SIGNAL_188 : 188|3@1+ (1,0) [0|7] "" XXX
CM_ BO_ 581 "Candidate new corner radar object payload on bus 1. 0x235-0x248 run near 33 Hz. Signal split and scales are derived from the public ZENDAR CAN-FD DBC FR_CMR object layout, then checked against the sampled IONIQ 5 PE rlog. In the sample, 0x235-0x239 carry active objects and 0x23a-0x248 mostly carry default payloads.";
CM_ SG_ 581 OBJ_REL_POS_X "ZENDAR FR_CMR_Obj_RelPosX-compatible candidate. In the sampled route, active slots decode to plausible object longitudinal positions.";
CM_ SG_ 581 OBJ_REL_POS_Y "ZENDAR FR_CMR_Obj_RelPosY-compatible candidate. Negative values were seen for objects on the right side in the sampled route.";
CM_ SG_ 581 OBJ_REL_ACCEL_X "This matches the GitHub hit at 115|9@1- named FR_CMR_Obj_RelAccelXxxVal in the public ZENDAR evaluation DBC.";
CM_ SG_ 581 TAIL_SIGNAL_140 "Unconfirmed tail field. Public ZENDAR FR_CMR layout uses this region for the next object's absolute velocity/metadata, but bytes 24-31 were zero in the sampled IONIQ 5 PE route.";
BA_ "GenMsgCycleTime" BO_ 581 30;

BO_ 582 CORNER_RADAR_235_OBJECTS_246: 32 RADAR
 SG_ CHECKSUM : 0|16@1+ (1,0) [0|65535] "" XXX
 SG_ COUNTER : 16|8@1+ (1,0) [0|255] "" XXX
 SG_ OBJ_QUAL_LEVEL : 24|7@1+ (1,0) [0|100] "%" XXX
 SG_ OBJ_ALIVE_AGE : 32|8@1+ (1,0) [0|255] "" XXX
 SG_ OBJ_MOVING_FLAG : 40|4@1+ (1,0) [0|15] "" XXX
 SG_ OBJ_ID : 44|7@1+ (1,0) [0|127] "" XXX
 SG_ OBJ_WIDTH : 52|8@1+ (0.01,0) [0|2.55] "m" XXX
 SG_ OBJ_CLASS : 60|4@1+ (1,0) [0|15] "" XXX
 SG_ OBJ_REL_POS_X : 64|13@1+ (0.05,0) [0|409.55] "m" XXX
 SG_ OBJ_REL_POS_Y : 78|12@1+ (0.05,-102.4) [-102.4|102.35] "m" XXX
 SG_ OBJ_REL_VEL_X : 91|12@1+ (0.05,-100) [-100|104.75] "m/s" XXX
 SG_ OBJ_REL_VEL_Y : 104|10@1+ (0.05,-25) [-25|26.15] "m/s" XXX
 SG_ OBJ_REL_ACCEL_X : 115|9@1- (0.05,0) [-12.8|12.75] "m/s^2" XXX
 SG_ OBJ_SYNC_FRAME_INDEX : 124|4@1+ (1,0) [0|15] "" XXX
 SG_ OBJ_ABS_VEL_X : 128|12@1+ (0.05,-102.4) [-102.4|102.35] "m/s" XXX
 SG_ TAIL_SIGNAL_140 : 140|12@1+ (1,0) [0|4095] "" XXX
 SG_ TAIL_SIGNAL_152 : 152|7@1+ (1,0) [0|127] "" XXX
 SG_ TAIL_SIGNAL_160 : 160|8@1+ (1,0) [0|255] "" XXX
 SG_ TAIL_SIGNAL_168 : 168|4@1+ (1,0) [0|15] "" XXX
 SG_ TAIL_SIGNAL_172 : 172|7@1+ (1,0) [0|127] "" XXX
 SG_ TAIL_SIGNAL_180 : 180|7@1+ (1,0) [0|127] "" XXX
 SG_ TAIL_SIGNAL_188 : 188|3@1+ (1,0) [0|7] "" XXX
CM_ BO_ 582 "Candidate new corner radar object payload on bus 1. 0x235-0x248 run near 33 Hz. Signal split and scales are derived from the public ZENDAR CAN-FD DBC FR_CMR object layout, then checked against the sampled IONIQ 5 PE rlog. In the sample, 0x235-0x239 carry active objects and 0x23a-0x248 mostly carry default payloads.";
CM_ SG_ 582 OBJ_REL_POS_X "ZENDAR FR_CMR_Obj_RelPosX-compatible candidate. In the sampled route, active slots decode to plausible object longitudinal positions.";
CM_ SG_ 582 OBJ_REL_POS_Y "ZENDAR FR_CMR_Obj_RelPosY-compatible candidate. Negative values were seen for objects on the right side in the sampled route.";
CM_ SG_ 582 OBJ_REL_ACCEL_X "This matches the GitHub hit at 115|9@1- named FR_CMR_Obj_RelAccelXxxVal in the public ZENDAR evaluation DBC.";
CM_ SG_ 582 TAIL_SIGNAL_140 "Unconfirmed tail field. Public ZENDAR FR_CMR layout uses this region for the next object's absolute velocity/metadata, but bytes 24-31 were zero in the sampled IONIQ 5 PE route.";
BA_ "GenMsgCycleTime" BO_ 582 30;

BO_ 583 CORNER_RADAR_235_OBJECTS_247: 32 RADAR
 SG_ CHECKSUM : 0|16@1+ (1,0) [0|65535] "" XXX
 SG_ COUNTER : 16|8@1+ (1,0) [0|255] "" XXX
 SG_ OBJ_QUAL_LEVEL : 24|7@1+ (1,0) [0|100] "%" XXX
 SG_ OBJ_ALIVE_AGE : 32|8@1+ (1,0) [0|255] "" XXX
 SG_ OBJ_MOVING_FLAG : 40|4@1+ (1,0) [0|15] "" XXX
 SG_ OBJ_ID : 44|7@1+ (1,0) [0|127] "" XXX
 SG_ OBJ_WIDTH : 52|8@1+ (0.01,0) [0|2.55] "m" XXX
 SG_ OBJ_CLASS : 60|4@1+ (1,0) [0|15] "" XXX
 SG_ OBJ_REL_POS_X : 64|13@1+ (0.05,0) [0|409.55] "m" XXX
 SG_ OBJ_REL_POS_Y : 78|12@1+ (0.05,-102.4) [-102.4|102.35] "m" XXX
 SG_ OBJ_REL_VEL_X : 91|12@1+ (0.05,-100) [-100|104.75] "m/s" XXX
 SG_ OBJ_REL_VEL_Y : 104|10@1+ (0.05,-25) [-25|26.15] "m/s" XXX
 SG_ OBJ_REL_ACCEL_X : 115|9@1- (0.05,0) [-12.8|12.75] "m/s^2" XXX
 SG_ OBJ_SYNC_FRAME_INDEX : 124|4@1+ (1,0) [0|15] "" XXX
 SG_ OBJ_ABS_VEL_X : 128|12@1+ (0.05,-102.4) [-102.4|102.35] "m/s" XXX
 SG_ TAIL_SIGNAL_140 : 140|12@1+ (1,0) [0|4095] "" XXX
 SG_ TAIL_SIGNAL_152 : 152|7@1+ (1,0) [0|127] "" XXX
 SG_ TAIL_SIGNAL_160 : 160|8@1+ (1,0) [0|255] "" XXX
 SG_ TAIL_SIGNAL_168 : 168|4@1+ (1,0) [0|15] "" XXX
 SG_ TAIL_SIGNAL_172 : 172|7@1+ (1,0) [0|127] "" XXX
 SG_ TAIL_SIGNAL_180 : 180|7@1+ (1,0) [0|127] "" XXX
 SG_ TAIL_SIGNAL_188 : 188|3@1+ (1,0) [0|7] "" XXX
CM_ BO_ 583 "Candidate new corner radar object payload on bus 1. 0x235-0x248 run near 33 Hz. Signal split and scales are derived from the public ZENDAR CAN-FD DBC FR_CMR object layout, then checked against the sampled IONIQ 5 PE rlog. In the sample, 0x235-0x239 carry active objects and 0x23a-0x248 mostly carry default payloads.";
CM_ SG_ 583 OBJ_REL_POS_X "ZENDAR FR_CMR_Obj_RelPosX-compatible candidate. In the sampled route, active slots decode to plausible object longitudinal positions.";
CM_ SG_ 583 OBJ_REL_POS_Y "ZENDAR FR_CMR_Obj_RelPosY-compatible candidate. Negative values were seen for objects on the right side in the sampled route.";
CM_ SG_ 583 OBJ_REL_ACCEL_X "This matches the GitHub hit at 115|9@1- named FR_CMR_Obj_RelAccelXxxVal in the public ZENDAR evaluation DBC.";
CM_ SG_ 583 TAIL_SIGNAL_140 "Unconfirmed tail field. Public ZENDAR FR_CMR layout uses this region for the next object's absolute velocity/metadata, but bytes 24-31 were zero in the sampled IONIQ 5 PE route.";
BA_ "GenMsgCycleTime" BO_ 583 30;

BO_ 584 CORNER_RADAR_235_OBJECTS_248: 32 RADAR
 SG_ CHECKSUM : 0|16@1+ (1,0) [0|65535] "" XXX
 SG_ COUNTER : 16|8@1+ (1,0) [0|255] "" XXX
 SG_ OBJ_QUAL_LEVEL : 24|7@1+ (1,0) [0|100] "%" XXX
 SG_ OBJ_ALIVE_AGE : 32|8@1+ (1,0) [0|255] "" XXX
 SG_ OBJ_MOVING_FLAG : 40|4@1+ (1,0) [0|15] "" XXX
 SG_ OBJ_ID : 44|7@1+ (1,0) [0|127] "" XXX
 SG_ OBJ_WIDTH : 52|8@1+ (0.01,0) [0|2.55] "m" XXX
 SG_ OBJ_CLASS : 60|4@1+ (1,0) [0|15] "" XXX
 SG_ OBJ_REL_POS_X : 64|13@1+ (0.05,0) [0|409.55] "m" XXX
 SG_ OBJ_REL_POS_Y : 78|12@1+ (0.05,-102.4) [-102.4|102.35] "m" XXX
 SG_ OBJ_REL_VEL_X : 91|12@1+ (0.05,-100) [-100|104.75] "m/s" XXX
 SG_ OBJ_REL_VEL_Y : 104|10@1+ (0.05,-25) [-25|26.15] "m/s" XXX
 SG_ OBJ_REL_ACCEL_X : 115|9@1- (0.05,0) [-12.8|12.75] "m/s^2" XXX
 SG_ OBJ_SYNC_FRAME_INDEX : 124|4@1+ (1,0) [0|15] "" XXX
 SG_ OBJ_ABS_VEL_X : 128|12@1+ (0.05,-102.4) [-102.4|102.35] "m/s" XXX
 SG_ TAIL_SIGNAL_140 : 140|12@1+ (1,0) [0|4095] "" XXX
 SG_ TAIL_SIGNAL_152 : 152|7@1+ (1,0) [0|127] "" XXX
 SG_ TAIL_SIGNAL_160 : 160|8@1+ (1,0) [0|255] "" XXX
 SG_ TAIL_SIGNAL_168 : 168|4@1+ (1,0) [0|15] "" XXX
 SG_ TAIL_SIGNAL_172 : 172|7@1+ (1,0) [0|127] "" XXX
 SG_ TAIL_SIGNAL_180 : 180|7@1+ (1,0) [0|127] "" XXX
 SG_ TAIL_SIGNAL_188 : 188|3@1+ (1,0) [0|7] "" XXX
CM_ BO_ 584 "Candidate new corner radar object payload on bus 1. 0x235-0x248 run near 33 Hz. Signal split and scales are derived from the public ZENDAR CAN-FD DBC FR_CMR object layout, then checked against the sampled IONIQ 5 PE rlog. In the sample, 0x235-0x239 carry active objects and 0x23a-0x248 mostly carry default payloads.";
CM_ SG_ 584 OBJ_REL_POS_X "ZENDAR FR_CMR_Obj_RelPosX-compatible candidate. In the sampled route, active slots decode to plausible object longitudinal positions.";
CM_ SG_ 584 OBJ_REL_POS_Y "ZENDAR FR_CMR_Obj_RelPosY-compatible candidate. Negative values were seen for objects on the right side in the sampled route.";
CM_ SG_ 584 OBJ_REL_ACCEL_X "This matches the GitHub hit at 115|9@1- named FR_CMR_Obj_RelAccelXxxVal in the public ZENDAR evaluation DBC.";
CM_ SG_ 584 TAIL_SIGNAL_140 "Unconfirmed tail field. Public ZENDAR FR_CMR layout uses this region for the next object's absolute velocity/metadata, but bytes 24-31 were zero in the sampled IONIQ 5 PE route.";
BA_ "GenMsgCycleTime" BO_ 584 30;
